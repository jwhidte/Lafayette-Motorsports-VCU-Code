/************************************************
* ASAP2 file
* Generated by Raptor 11/13/2024 6:07:57 PM
* New Eagle, LLC 2012
* Machine: LAPTOP-JHON
* User : Jhon
* OS : Microsoft Windows NT 6.2.9200.0
************************************************/ ASAP2_VERSION 1 51
/begin PROJECT Accelerator_021
/*LongIdentifier (BUILD_UID) */ "xiIDgJNohkmnMD1DVBsmI"
/begin MODULE Accelerator
/*LongIdentifier (XCPProdID) */ "20037"
/begin IF_DATA XCP
 /begin PROTOCOL_LAYER /* XCP protocol layer version */ 0x100 /* T1 [ms] */ 2000 /* T2 [ms] */ 2000 /* T3 [ms] */ 2000 /* T4 [ms] */ 2000 /* T5 [ms] */ 2000 /* T6 [ms] */ 0050 /* T7 [ms] */ 0050 /* MAX_CTO */ 8 /* MAX_DTO */ 8 /* BYTE_ORDER */ BYTE_ORDER_MSB_LAST /* ADDRESS_GRANULARITY */ ADDRESS_GRANULARITY_BYTE OPTIONAL_CMD SET_REQUEST OPTIONAL_CMD SET_MTA OPTIONAL_CMD UPLOAD OPTIONAL_CMD BUILD_CHECKSUM OPTIONAL_CMD TRANSPORT_LAYER_CMD OPTIONAL_CMD CLEAR_DAQ_LIST OPTIONAL_CMD SET_DAQ_PTR OPTIONAL_CMD WRITE_DAQ OPTIONAL_CMD SET_DAQ_LIST_MODE OPTIONAL_CMD START_STOP_DAQ_LIST OPTIONAL_CMD START_STOP_SYNCH OPTIONAL_CMD GET_DAQ_CLOCK OPTIONAL_CMD FREE_DAQ OPTIONAL_CMD ALLOC_DAQ OPTIONAL_CMD ALLOC_ODT OPTIONAL_CMD ALLOC_ODT_ENTRY OPTIONAL_CMD GET_SEED OPTIONAL_CMD UNLOCK OPTIONAL_CMD GET_DAQ_RESOLUTION_INFO OPTIONAL_CMD GET_DAQ_PROCESSOR_INFO OPTIONAL_CMD DOWNLOAD OPTIONAL_CMD GET_COMM_MODE_INFO
  /begin COMMUNICATION_MODE_SUPPORTED /begin BLOCK SLAVE MASTER /* MAX_BS */ 0xff /* MIN_ST */ 100 /end BLOCK /end COMMUNICATION_MODE_SUPPORTED
  SEED_AND_KEY_EXTERNAL_FUNCTION "raptor_XCPSecurity.dll" /end PROTOCOL_LAYER
 /begin DAQ /* DAQ_CONFIG_TYPE */ DYNAMIC /* MAX_DAQ */ 2 /* MAX_EVENT_CHANNEL */ 2 /* MIN_DAQ */ 0 /* OPTIMISATION_TYPE */ OPTIMISATION_TYPE_DEFAULT /* ADDRESS_EXTENSION */ ADDRESS_EXTENSION_DAQ /* IDENTIFICATION_FIELD */ IDENTIFICATION_FIELD_TYPE_ABSOLUTE /* GRANULARITY_ODT_ENTRY_SIZE_DAQ */ GRANULARITY_ODT_ENTRY_SIZE_DAQ_BYTE /* MAX_ODT_ENTRY_SIZE_DAQ */ 4 /* OVERLOAD_INDICATION */ NO_OVERLOAD_INDICATION
  /begin TIMESTAMP_SUPPORTED /* TIMESTAMP_TICKS */ 1 /* TIMESTAMP_SIZE */ SIZE_DWORD /* TIMESTAMP_RESOLUTION */ UNIT_1MS /end TIMESTAMP_SUPPORTED
  /begin EVENT /* EVENT_CHANNEL_NAME */ "List_10ms" /* EVENT_CHANNEL_SHORT_NAME */ "EV_0" /* EVENT_CHANNEL_NUMBER */ 0 /* EVENT_CHANNEL_DIRECTION */ DAQ /* MAX_DAQ_LIST */ 10 /* TIME_CYCLE */ 10 /* TIME_UNIT */ 6 /* PRIORITY */ 0 /end EVENT
  /begin EVENT /* EVENT_CHANNEL_NAME */ "List_100ms" /* EVENT_CHANNEL_SHORT_NAME */ "EV_1" /* EVENT_CHANNEL_NUMBER */ 1 /* EVENT_CHANNEL_DIRECTION */ DAQ /* MAX_DAQ_LIST */ 10 /* TIME_CYCLE */ 100 /* TIME_UNIT */ 6 /* PRIORITY */ 0 /end EVENT
 /end DAQ
 /begin XCP_ON_CAN /* XCP on CAN 1.0 */ 0x0100 /* auto-detection -- Bit31= 1: EXT */ CAN_ID_BROADCAST 0x100 /* CMD/STIM (master -> slave) -- Bit31= 1: EXT */ CAN_ID_MASTER 0x200 /* RES/ERR/EV/SERV/DAQ (slave -> master) -- Bit31= 1: EXT */ CAN_ID_SLAVE 0x300 /* In Hz */ BAUDRATE 250000 /* Percentage of complete bit time. */ SAMPLE_POINT 75 SAMPLE_RATE SINGLE /* Slots per bit time. */ BTL_CYCLES 0 /* Length of the synch segment. */ SJW 2 /* Sync Edge */ SYNC_EDGE SINGLE /end XCP_ON_CAN
/end IF_DATA
/begin MOD_PAR /* COMMENT */ "" ECU_CALIBRATION_OFFSET 0x00000000 ADDR_EPK 0x800382E3 EPK "xiIDgJNohkmnMD1DVBsmI"
 /begin MEMORY_SEGMENT CODE1 "Interrupt & Reset Vectors, Version Infos, Checksum Info" RESERVED FLASH INTERN 0x80000000 0x00020000 -1 -1 -1 -1 -1
  /begin IF_DATA XCP
   /begin SEGMENT 0 0x01 0x00 0x00 0x00 /begin CHECKSUM XCP_CRC_16_CITT /end CHECKSUM /end SEGMENT
  /end IF_DATA
 /end MEMORY_SEGMENT
 /begin MEMORY_SEGMENT BSW "BSW" CODE FLASH INTERN 0x80020000 0x00017FF8 -1 -1 -1 -1 -1
  /begin IF_DATA XCP
   /begin SEGMENT 6 0x01 0x00 0x00 0x00 /begin CHECKSUM XCP_CRC_16_CITT /end CHECKSUM /end SEGMENT
  /end IF_DATA
 /end MEMORY_SEGMENT
 /begin MEMORY_SEGMENT EDIT_CALS "RAM Calibration Space" DATA FLASH INTERN 0x80037FF8 0x000000AC -1 -1 -1 -1 -1
  /begin IF_DATA XCP
   /begin SEGMENT 1 0x01 0x00 0x00 0x00 /begin CHECKSUM XCP_CRC_16_CITT /end CHECKSUM /begin ADDRESS_MAPPING 0x80037FF8 0xB000059C 0x000000AC /end ADDRESS_MAPPING /end SEGMENT
  /end IF_DATA
 /end MEMORY_SEGMENT
 /begin MEMORY_SEGMENT EEPROM_CALS "Calibration Space" DATA EEPROM INTERN 0x800380A4 0x000001CC -1 -1 -1 -1 -1
  /begin IF_DATA XCP
   /begin SEGMENT 2 0x01 0x00 0x00 0x00 /begin CHECKSUM XCP_CRC_16_CITT /end CHECKSUM /begin ADDRESS_MAPPING 0x800380A4 0xB00003D0 0x000001CC /end ADDRESS_MAPPING /end SEGMENT
  /end IF_DATA
 /end MEMORY_SEGMENT
 /begin MEMORY_SEGMENT ConstFLASH "Const FLASH Space" CODE FLASH INTERN 0x80038270 0x000000A4 -1 -1 -1 -1 -1
  /begin IF_DATA XCP
   /begin SEGMENT 4 0x01 0x00 0x00 0x00 /begin CHECKSUM XCP_CRC_16_CITT /end CHECKSUM /end SEGMENT
  /end IF_DATA
 /end MEMORY_SEGMENT
 /begin MEMORY_SEGMENT CODE2 "Application Code" RESERVED FLASH INTERN 0x80038314 0x001C7CEC -1 -1 -1 -1 -1
  /begin IF_DATA XCP
   /begin SEGMENT 5 0x01 0x00 0x00 0x00 /begin CHECKSUM XCP_CRC_16_CITT /end CHECKSUM /end SEGMENT
  /end IF_DATA
 /end MEMORY_SEGMENT
 /begin MEMORY_SEGMENT ASW2 "Application Code" CODE FLASH INTERN 0x80800000 0x00180000 -1 -1 -1 -1 -1
  /begin IF_DATA XCP
   /begin SEGMENT 7 0x01 0x00 0x00 0x00 /begin CHECKSUM XCP_CRC_16_CITT /end CHECKSUM /end SEGMENT
  /end IF_DATA
 /end MEMORY_SEGMENT
 /begin MEMORY_SEGMENT BSW_Cals "BSW Cals" DATA FLASH INTERN 0x80980000 0x0007C000 -1 -1 -1 -1 -1
  /begin IF_DATA XCP
   /begin SEGMENT 8 0x01 0x00 0x00 0x00 /begin CHECKSUM XCP_CRC_16_CITT /end CHECKSUM /end SEGMENT
  /end IF_DATA
 /end MEMORY_SEGMENT
 /begin MEMORY_SEGMENT MeasurmentRAM2 "Measurement Space2" VARIABLES RAM INTERN 0xB0000000 0x00020000 -1 -1 -1 -1 -1
  /begin IF_DATA XCP
   /begin SEGMENT 10 0x01 0x00 0x00 0x00 /begin CHECKSUM XCP_CRC_16_CITT /end CHECKSUM /end SEGMENT
  /end IF_DATA
 /end MEMORY_SEGMENT
 /begin MEMORY_SEGMENT MeasurmentRAM "Measurement Space" VARIABLES RAM INTERN 0xD0000000 0x00020000 -1 -1 -1 -1 -1
  /begin IF_DATA XCP
   /begin SEGMENT 9 0x01 0x00 0x00 0x00 /begin CHECKSUM XCP_CRC_16_CITT /end CHECKSUM /end SEGMENT
  /end IF_DATA
 /end MEMORY_SEGMENT
 /* 0x80000000 - 0x80020000 : CODE1 */ /* 0x80020000 - 0x80037FF8 : BSW */ /* 0x80037FF8 - 0x800380A4 : EDIT_CALS */ /* 0x800380A4 - 0x80038270 : EEPROM_CALS */ /* 0x80038270 - 0x80038314 : ConstFLASH */ /* 0x80038314 - 0x80200000 : CODE2 */ /* 0x80800000 - 0x80980000 : ASW2 */ /* 0x80980000 - 0x809FC000 : BSW_Cals */ /* 0xB0000000 - 0xB0020000 : MeasurmentRAM2 */ /* 0xD0000000 - 0xD0020000 : MeasurmentRAM */ /end MOD_PAR
/begin MOD_COMMON /* COMMENT */ "" BYTE_ORDER MSB_LAST ALIGNMENT_BYTE 1 ALIGNMENT_FLOAT32_IEEE 1 ALIGNMENT_FLOAT64_IEEE 1 ALIGNMENT_LONG 1 ALIGNMENT_WORD 1 /end MOD_COMMON
/begin RECORD_LAYOUT RECORD_LAYOUT__4 AXIS_PTS_X 1 FLOAT32_IEEE /* IndexIncr */ INDEX_INCR /* Addressing */ DIRECT /end RECORD_LAYOUT
/begin RECORD_LAYOUT RECORD_LAYOUT__1 FNC_VALUES 1 FLOAT32_IEEE ROW_DIR DIRECT /end RECORD_LAYOUT
/begin RECORD_LAYOUT RECORD_LAYOUT__2 FNC_VALUES 1 UBYTE ROW_DIR DIRECT /end RECORD_LAYOUT
/begin RECORD_LAYOUT RECORD_LAYOUT__5 FNC_VALUES 1 ULONG ROW_DIR DIRECT /end RECORD_LAYOUT
/begin RECORD_LAYOUT RECORD_LAYOUT__3 FNC_VALUES 1 UWORD ROW_DIR DIRECT /end RECORD_LAYOUT
/begin COMPU_METHOD COMPU_METHOD__16 "" RAT_FUNC "%3.0" "" COEFFS 0 1 0 0 0 1 /end COMPU_METHOD
/begin COMPU_METHOD COMPU_METHOD__17 "" RAT_FUNC "%4.0" "" COEFFS 0 1 0 0 0 1 /end COMPU_METHOD
/begin COMPU_METHOD COMPU_METHOD__20 "" RAT_FUNC "%4.0" "ms" COEFFS 0 1 0 0 0 1 /end COMPU_METHOD
/begin COMPU_METHOD COMPU_METHOD__26 "" RAT_FUNC "%4.0" "NA" COEFFS 0 1 0 0 0 1 /end COMPU_METHOD
/begin COMPU_METHOD COMPU_METHOD__22 "" RAT_FUNC "%4.0" "Sec" COEFFS 0 1 0 0 0 0.1 /end COMPU_METHOD
/begin COMPU_METHOD COMPU_METHOD__7 "" RAT_FUNC "%5.0" "" COEFFS 0 1 0 0 0 1 /end COMPU_METHOD
/begin COMPU_METHOD COMPU_METHOD__1 "" RAT_FUNC "%5.0" "Bool" COEFFS 0 1 0 0 0 1 /end COMPU_METHOD
/begin COMPU_METHOD COMPU_METHOD__13 "" RAT_FUNC "%5.0" "Hz" COEFFS 0 1 0 0 0 100 /end COMPU_METHOD
/begin COMPU_METHOD COMPU_METHOD__19 "" RAT_FUNC "%6.0" "cnt" COEFFS 0 1 0 0 0 1 /end COMPU_METHOD
/begin COMPU_METHOD COMPU_METHOD__27 "" RAT_FUNC "%6.2" "NA" COEFFS 0 1 0 0 0 0.00152588 /end COMPU_METHOD
/begin COMPU_METHOD COMPU_METHOD__12 "" RAT_FUNC "%7.0" "Counts" COEFFS 0 1 0 0 0 1 /end COMPU_METHOD
/begin COMPU_METHOD COMPU_METHOD__2 "" RAT_FUNC "%7.2" "" COEFFS 0 1 0 0 0 1 /end COMPU_METHOD
/begin COMPU_METHOD COMPU_METHOD__8 "" RAT_FUNC "%7.2" "ADC" COEFFS 0 1 0 0 0 1 /end COMPU_METHOD
/begin COMPU_METHOD COMPU_METHOD__4 "" RAT_FUNC "%7.2" "Ah" COEFFS 0 1 0 0 0 1 /end COMPU_METHOD
/begin COMPU_METHOD COMPU_METHOD__15 "" RAT_FUNC "%7.2" "deg/sec" COEFFS 0 1 0 0 0 1 /end COMPU_METHOD
/begin COMPU_METHOD COMPU_METHOD__11 "" RAT_FUNC "%7.2" "degC/sec" COEFFS 0 1 0 0 0 1 /end COMPU_METHOD
/begin COMPU_METHOD COMPU_METHOD__5 "" RAT_FUNC "%7.2" "F" COEFFS 0 1 0 0 0 1 /end COMPU_METHOD
/begin COMPU_METHOD COMPU_METHOD__14 "" RAT_FUNC "%7.2" "GPM" COEFFS 0 1 0 0 0 1 /end COMPU_METHOD
/begin COMPU_METHOD COMPU_METHOD__10 "" RAT_FUNC "%7.2" "Nm" COEFFS 0 1 0 0 0 1 /end COMPU_METHOD
/begin COMPU_METHOD COMPU_METHOD__9 "" RAT_FUNC "%7.2" "RPM" COEFFS 0 1 0 0 0 1 /end COMPU_METHOD
/begin COMPU_METHOD COMPU_METHOD__3 "" RAT_FUNC "%7.2" "sec" COEFFS 0 1 0 0 0 1 /end COMPU_METHOD
/begin COMPU_METHOD COMPU_METHOD__28 "" RAT_FUNC "%7.3" "flag" COEFFS 0 1 0 0 0 1 /end COMPU_METHOD
/begin COMPU_METHOD COMPU_METHOD__21 "" TAB_VERB "%1.0" "" COMPU_TAB_REF COMPU_VTAB__3 /end COMPU_METHOD
/begin COMPU_METHOD COMPU_METHOD__6 "" TAB_VERB "%3.0" "" COMPU_TAB_REF COMPU_VTAB__1 /end COMPU_METHOD
/begin COMPU_METHOD COMPU_METHOD__29 "" TAB_VERB "%3.0" "" COMPU_TAB_REF COMPU_VTAB__7 /end COMPU_METHOD
/begin COMPU_METHOD COMPU_METHOD__23 "" TAB_VERB "%4.0" "" COMPU_TAB_REF COMPU_VTAB__4 /end COMPU_METHOD
/begin COMPU_METHOD COMPU_METHOD__24 "" TAB_VERB "%4.0" "" COMPU_TAB_REF COMPU_VTAB__5 /end COMPU_METHOD
/begin COMPU_METHOD COMPU_METHOD__25 "" TAB_VERB "%4.0" "" COMPU_TAB_REF COMPU_VTAB__6 /end COMPU_METHOD
/begin COMPU_METHOD COMPU_METHOD__18 "" TAB_VERB "%6.0" "" COMPU_TAB_REF COMPU_VTAB__2 /end COMPU_METHOD
/begin COMPU_VTAB COMPU_VTAB__6 "" TAB_VERB 11 0 "SWRESET_GRP_POWERON_E" 1 "SWRESET_GRP_HWRESET_E" 2 "SWRESET_GRP_WDT_E" 3 "SWRESET_GRP_WAKEUP_E" 4 "SWRESET_GRP_TRAP_E" 5 "SWRESET_GRP_SB_E" 6 "SWRESET_GRP_CB_E" 7 "SWRESET_SOFTRESETGRP_E" 8 "SWRESET_GRP_DUMMY_01" 9 "SWRESET_GRP_DUMMY_02" 10 "SWRESET_GRP_SYC_KL15RST_E" /end COMPU_VTAB
/begin COMPU_VTAB COMPU_VTAB__7 "" TAB_VERB 13 0 "Initialization" 1 "Loaded Defaults - Manual" 2 "Loaded Defaults - After Reprogramming" 3 "Loaded Defaults - Incorrect CRC" 4 "Loaded Defaults - Incorrect EE Format" 5 "Loaded Defaults - Error Reading EEPROM" 6 "Loaded Defaults - Failed Driver Initialization" 7 "Loaded Saved Values - After Reprogramming" 8 "Loaded Saved Values - Normal Startup" 9 "Loaded Saved Values - Backup Copy" 10 "Store In Progess" 11 "Store Attempt Failed" 12 "Store Succeeded" /end COMPU_VTAB
/begin COMPU_VTAB COMPU_VTAB__4 "" TAB_VERB 156 0 "SWRESET_POWERON_E" 1 "SWRESET_POWERON_WDT_E" 2 "SWRESET_POWERON_KL15_E" 3 "SWRESET_HW_E" 4 "SWRESET_WDT_E" 4096 "TRAP_MMU_VAF_E" 4097 "TRAP_MMU_VAP_E" 4098 "TRAP_INTPROT_PRIV_E" 4099 "TRAP_INTPROT_MPR_E" 4100 "TRAP_INTPROT_MPW_E" 4101 "TRAP_INTPROT_MPX_E" 4102 "TRAP_INTPROT_MPP_E" 4103 "TRAP_INTPROT_MPN_E" 4104 "TRAP_INTPROT_GRWP_E" 4105 "TRAP_INSTRERR_IOPC_E" 4106 "TRAP_INSTRERR_UOPC_E" 4107 "TRAP_INSTRERR_OPD_E" 4108 "TRAP_INSTRERR_ALN_E" 4109 "TRAP_INSTRERR_MEM_E" 4110 "TRAP_CONTMANA_FCD_E" 4111 "TRAP_CONTMANA_CDO_E" 4112 "TRAP_CONTMANA_CDU_E" 4113 "TRAP_CONTMANA_FCU_E" 4114 "TRAP_CONTMANA_CSU_E" 4115 "TRAP_CONTMANA_CTYP_E" 4116 "TRAP_CONTMANA_NEST_E" 4117 "TRAP_SYSBUSERR_PSE_E" 4118 "TRAP_SYSBUSERR_DSE_E" 4119 "TRAP_SYSBUSERR_DAE_E" 4120 "TRAP_SYSBUSERR_CAE_E" 4121 "TRAP_SYSBUSERR_PIE_E" 4122 "TRAP_SYSBUSERR_DIE_E" 4123 "TRAP_ASSTRAP_OVF_E" 4124 "TRAP_ASSTRAP_SOVF_E" 4125 "TRAP_SYSCALL_SYS_E" 4126 "TRAP_NMI_ESR0_E" 4127 "TRAP_NMI_ESR1_E" 4128 "TRAP_NMI_RES0_E" 4129 "TRAP_NMI_WDT_E" 4130 "TRAP_NMI_PE_E" 4131 "TRAP_NMI_OSCLWD_E" 4132 "TRAP_NMI_OSCHWD_E" 4133 "TRAP_NMI_OSCSPWD_E" 4134 "TRAP_NMI_SYSVCOLCK_E" 4135 "TRAP_NMI_ERAYVCOLCKT" 4136 "TRAP_NMI_FLOT_E" 4137 "TRAP_PE_P_IED_E" 4138 "TRAP_PE_P_IE_T_E" 4139 "TRAP_PE_P_IE_C_E" 4140 "TRAP_PE_P_IE_S_E" 4141 "TRAP_PE_P_IE_B_E" 4142 "TRAP_PE_D_IED_E" 4143 "TRAP_PE_D_IE_T_E" 4144 "TRAP_PE_D_IE_C_E" 4145 "TRAP_PE_D_IE_S_E" 4146 "TRAP_PE_D_IE_B_E" 4147 "TRAP_NMIPE_LDRAM_DSPR_E" 4148 "TRAP_NMIPE_DTAG_E" 4149 "TRAP_NMIPE_SPRAM_PSPR_E" 4150 "TRAP_NMIPE_PTAG_E" 4151 "TRAP_NMIPE_PMU_LMU_E" 4152 "TRAP_NMIPE_PRAM_E" 4153 "TRAP_NMIPE_CMEM_E" 4154 "TRAP_NMIPE_CAN_E" 4155 "TRAP_NMIPE_ERAY_E" 4156 "TRAP_NMIPE_SRI_E" 4157 "TRAP_NMIPE_EBU_E" 4158 "TRAP_NMIPE_BMU_E" 8192 "SWRESET_POWERON_SIMU_E" 8193 "SWRESET_HRESET_SIMU_E" 8194 "SWRESET_RB_PROG_E" 8195 "SWRESET_SOFTRESET_5VUNDERVOLTAGE_E" 8196 "SWRESET_SOFTRESET_POSTDRV2PREDRV_E" 8197 "SWRESET_CBPROG_E" 8198 "SWRESET_CBCPU_E" 8199 "SWRESET_RB_PROG_ILLEGAL_PATH_E" 8200 "SWRESET_TSW_EXIT_E" 8201 "SWRESET_TSW_HWTEST_FAIL_E" 8202 "SWRESET_TRPOT_FAIL_E" 8203 "SWRESET_OBD_SVC11_RESET_E" 8204 "SWRESET_SBDUMMY_6_E" 8205 "SWRESET_SBDUMMY_7_E" 8206 "SWRESET_SBDUMMY_8_E" 12288 "SWRST_EEPBANDGAP_E" 12289 "SWRST_EEPNODEBUGGER_E" 12290 "SWRST_EEPDELENVRAM_E" 12291 "SWRST_WRITE_ERRORS_SECTORCHANGE_E" 12292 "SWRST_EEPACTFIRSTINIT_E" 12293 "RESET_SWRESET_EPMHCRS_WAIT_PCP_RESET_E" 12294 "RESET_SWRESET_ESC_SCHED_RESET_E" 12295 "SWRST_EXECON_FAULTYSTATE_E" 12296 "RESET_SWRESET_ILLEGAL_OPCODE" 12297 "RESET_SWRESET_ILLEGAL_RETURN_TO_MAIN" 12298 "RESET_SWRESET_MEMLAY_MP_ACCESS" 12299 "SWRESET_MOCADCNTP_PREICO" 12300 "SWRESET_MOCADCTST_PREICO" 12301 "RESET_SWRESET_ILLEGAL_SW_PATH" 12302 "RESET_SWRESET_MOCCOM_SPI_ERROR" 12303 "RESET_SWRESET_MOCCOM_CTSOPTST" 12304 "RESET_SWRESET_MOCCOM_SOPTST" 12305 "RESET_SWRESET_MOCCOM_CPLCHK_FAILED" 12306 "RESET_SWRESET_MOCCOM_OS_TIMEOUT_ERROR" 12307 "RESET_SWRESET_MOCGPTA" 12308 "RESET_SWRESET_MOCMEM_CPLCHK_FAILED" 12309 "RESET_SWRESET_MOCMEM_CHKRAM_FAILED" 12310 "RESET_SWRESET_MOCMEM_CHKROM_FAILED" 12311 "RESET_SWRESET_MOCMEM_WTRAM_FAILED" 12312 "RESET_SWRESET_MOCMEM_WTROM_FAILED" 12313 "RESET_SWRESET_MOCPCP" 12314 "RESET_SWRESET_MOCRAM_WRI" 12315 "RESET_SWRESET_MOCRAM_CPL" 12316 "RESET_SWRESET_MOCRAM_RAMTAB" 12317 "RESET_SWRESET_MOCRAM_RSTPTRRAM" 12318 "RESET_SWRESET_MOCRAM_STACKRAM" 12319 "RESET_SWRESET_MOCRAM_CSARAM" 12320 "RESET_SWRESET_MOCRAM_XRAM" 12321 "RESET_SWRESET_MOCRAM_IRAM" 12322 "RESET_SWRESET_MOCRAM_EXRAM" 12323 "RESET_SWRESET_MOCRAM_PROTRAM" 12324 "RESET_SWRESET_MOCRAM_EEPCPL" 12325 "RESET_SWRESET_MOCRAM_REPEXOK" 12326 "RESET_SWRESET_MOCROM" 12327 "RESET_SWRESET_MOCROM_CPL" 12328 "RESET_SWRESET_MOCROM_INDEX" 12329 "RESET_SWRESET_SOPTEST_FAILED" 12330 "RESET_SWRESET_CPLCHK_FAILED" 12331 "RESET_SWRESET_MOCSOP_MSC_ERROR" 12332 "RESET_SWRESET_MOCSOP_SPI_ERROR" 12333 "RESET_SWRESET_MOCSOP_OS_TIMEOUT_ERROR" 12334 "RESET_SWRESET_MOCSOP_TIRESPTIME_ERROR" 12335 "SWRESET_OCWDA_WDA_ACTV" 12336 "SWRESET_OCWDA_WDA_MONITOR" 12337 "SWRESET_OCWDA_LOW_VLTG" 12338 "SWRESET_OCWDA_OVR_VLTG" 12339 "RESET_SWRESET_INTERRUPTLOCK_EXPECTED" 12340 "RESET_USERSTACKOVERFLOW_DETECTED" 12341 "SWRST_HWEMONDEFAULT_E" 12342 "RESET_ERRINTR_E" 12343 "SWRESET_CALWAKEUP_E" 12344 "SWRESET_DEADLINE1MS_E" 12345 "SWRESET_DEADLINE10MS_E" 12346 "SWRESET_DEADLINEBG_E" 12347 "SWRESET_NMIDISABLED_E" 12348 "SWRESET_POSTDRIVE_E" 12349 "SWRESET_UNEXPSYCSTSUB_E" 12350 "SWRESET_SOFTRESET_WAKEUP_E" 12351 "SWRESET_SOFTRESET_SHUTDOWN_E" 12352 "SWRESET_UNDERVOLTAGE_E" 12353 "RESET_SWRESET_SWOVER_DONE" 12354 "SWRESET_UNSUPPORTED_CPU_E" 12355 "SWRST_CAN_MESSAGECONFIG" 12356 "SWRST_ADCI_ERROR_E" 12357 "SWRST_PMD_PM_ERROR_E" 12358 "RESET_DMA_ERROR_E" 12359 "SWRST_FLASHCONFIG_E" 12360 "SWRESET_PCP_ERROR_E" /end COMPU_VTAB
/begin COMPU_VTAB COMPU_VTAB__2 "" TAB_VERB 2 0 "None" 20037 "Standard" /end COMPU_VTAB
/begin COMPU_VTAB COMPU_VTAB__1 "" TAB_VERB 2 0 "Pass Through" 1 "Override" /end COMPU_VTAB
/begin COMPU_VTAB COMPU_VTAB__3 "" TAB_VERB 3 0 "Normal Operation" 1 "Force Unsuspected" 2 "Force Suspected" /end COMPU_VTAB
/begin COMPU_VTAB COMPU_VTAB__5 "" TAB_VERB 5 0 "OCWDA_CO_WDA_NOT_ACTV" -1802201964 "OCWDA_CO_WDA_OVRVLTG" -1431655766 "OCWDA_CO_WDA_ACTV" -1246382667 "OCWDA_CO_WDA_MONITOR" -943208505 "OCWDA_CO_WDA_LOWVLTG" /end COMPU_VTAB
/begin MEASUREMENT AbsoluteTime "" FLOAT32_IEEE COMPU_METHOD__2 0 0 -1E+17 1E+17 ECU_ADDRESS 0xB00002DC /begin FUNCTION_LIST FunctionCall_Subsystem /end FUNCTION_LIST /end MEASUREMENT
/begin MEASUREMENT APP1 "" FLOAT32_IEEE COMPU_METHOD__2 0 0 -1E+17 1E+17 ECU_ADDRESS 0xB0000338 /begin FUNCTION_LIST Foreground /end FUNCTION_LIST /end MEASUREMENT
/begin MEASUREMENT APP2 "" FLOAT32_IEEE COMPU_METHOD__2 0 0 -1E+17 1E+17 ECU_ADDRESS 0xB000033C /begin FUNCTION_LIST Foreground /end FUNCTION_LIST /end MEASUREMENT
/begin MEASUREMENT B_pwf "Power fail bit." UBYTE COMPU_METHOD__26 0 0 0 255 ECU_ADDRESS 0xD000001B /begin FUNCTION_LIST Platform /end FUNCTION_LIST /end MEASUREMENT
/begin MEASUREMENT Battery_Percent_Charge "" FLOAT32_IEEE COMPU_METHOD__4 0 0 -1E+17 1E+17 ECU_ADDRESS 0xB00002E4 /begin FUNCTION_LIST GLV_Used_Ah /end FUNCTION_LIST /end MEASUREMENT
/begin MEASUREMENT BMS_SOC_percent "" UWORD COMPU_METHOD__7 0 0 0 65535 ECU_ADDRESS 0xB0000360 /begin FUNCTION_LIST Foreground /end FUNCTION_LIST /end MEASUREMENT
/begin MEASUREMENT CAN1_CANRX_QueueCount "Number of messages currently in CAN1 transmission queue." UBYTE COMPU_METHOD__19 0 0 0 100 ECU_ADDRESS 0xB000036C /begin FUNCTION_LIST CAN /end FUNCTION_LIST /end MEASUREMENT
/begin MEASUREMENT CAN1_CANRX_QueueMax "Max number of messages seen in CAN1 transmission queue." UBYTE COMPU_METHOD__19 0 0 0 100 ECU_ADDRESS 0xB000036D /begin FUNCTION_LIST CAN /end FUNCTION_LIST /end MEASUREMENT
/begin MEASUREMENT CAN1_CANRX_QueueOverrun "Number of times the CAN1 transmission queue has overrun." UBYTE COMPU_METHOD__19 0 0 0 255 ECU_ADDRESS 0xB000036B /begin FUNCTION_LIST CAN /end FUNCTION_LIST /end MEASUREMENT
/begin MEASUREMENT CAN1_CANTX_QueueCount "Number of messages currently in CAN1 transmission queue." UBYTE COMPU_METHOD__19 0 0 0 100 ECU_ADDRESS 0xB0000369 /begin FUNCTION_LIST CAN /end FUNCTION_LIST /end MEASUREMENT
/begin MEASUREMENT CAN1_CANTX_QueueMax "Max number of messages seen in CAN1 transmission queue." UBYTE COMPU_METHOD__19 0 0 0 100 ECU_ADDRESS 0xB000036A /begin FUNCTION_LIST CAN /end FUNCTION_LIST /end MEASUREMENT
/begin MEASUREMENT CAN1_CANTX_QueueOverrun "Number of times the CAN1 transmission queue has overrun." UBYTE COMPU_METHOD__19 0 0 0 255 ECU_ADDRESS 0xB0000368 /begin FUNCTION_LIST CAN /end FUNCTION_LIST /end MEASUREMENT
/begin MEASUREMENT CAN2_CANTX_QueueCount "Number of messages currently in CAN2 transmission queue." UBYTE COMPU_METHOD__19 0 0 0 100 ECU_ADDRESS 0xB000036F /begin FUNCTION_LIST CAN /end FUNCTION_LIST /end MEASUREMENT
/begin MEASUREMENT CAN2_CANTX_QueueMax "Max number of messages seen in CAN2 transmission queue." UBYTE COMPU_METHOD__19 0 0 0 100 ECU_ADDRESS 0xB0000370 /begin FUNCTION_LIST CAN /end FUNCTION_LIST /end MEASUREMENT
/begin MEASUREMENT CAN2_CANTX_QueueOverrun "Number of times the CAN2 transmission queue has overrun." UBYTE COMPU_METHOD__19 0 0 0 255 ECU_ADDRESS 0xB000036E /begin FUNCTION_LIST CAN /end FUNCTION_LIST /end MEASUREMENT
/begin MEASUREMENT Charge_mode "" UBYTE COMPU_METHOD__7 0 0 0 1 ECU_ADDRESS 0xB0000319 /begin FUNCTION_LIST Foreground /end FUNCTION_LIST /end MEASUREMENT
/begin MEASUREMENT ContextSaveAreaSize "Current % System Context Save Area Consumption." UWORD COMPU_METHOD__27 0 0 0 99.9985458 ECU_ADDRESS 0xD000A1F4 /begin FUNCTION_LIST Platform /end FUNCTION_LIST /end MEASUREMENT
/begin MEASUREMENT Cooling_fault_any "" UBYTE COMPU_METHOD__7 0 0 0 1 ECU_ADDRESS 0xB0000318 /begin FUNCTION_LIST Foreground /end FUNCTION_LIST /end MEASUREMENT
/begin MEASUREMENT Counter "" FLOAT32_IEEE COMPU_METHOD__2 0 0 -1E+17 1E+17 ECU_ADDRESS 0xB000034C /begin FUNCTION_LIST Foreground /end FUNCTION_LIST /end MEASUREMENT
/begin MEASUREMENT Direction_cmd "" FLOAT32_IEEE COMPU_METHOD__2 0 0 -1E+17 1E+17 ECU_ADDRESS 0xB0000308 /begin FUNCTION_LIST Command_Troque /end FUNCTION_LIST /end MEASUREMENT
/begin MEASUREMENT Drive_enable "" UBYTE COMPU_METHOD__7 0 0 0 1 ECU_ADDRESS 0xB0000341 /begin FUNCTION_LIST Foreground /end FUNCTION_LIST /end MEASUREMENT
/begin MEASUREMENT EEPROM_State "EEPROM State on startup." UBYTE COMPU_METHOD__29 0 0 0 255 ECU_ADDRESS 0xB00003CC /begin FUNCTION_LIST System /end FUNCTION_LIST /end MEASUREMENT
/begin MEASUREMENT Fan_PWM_D "" UWORD COMPU_METHOD__7 0 0 0 65535 ECU_ADDRESS 0xB0000328 /begin FUNCTION_LIST Foreground /end FUNCTION_LIST /end MEASUREMENT
/begin MEASUREMENT fault_eradic_temp "" UBYTE COMPU_METHOD__7 0 0 0 1 ECU_ADDRESS 0xB000031E /begin FUNCTION_LIST Foreground /end FUNCTION_LIST /end MEASUREMENT
/begin MEASUREMENT fault_eradicFlowRate "" UBYTE COMPU_METHOD__7 0 0 0 1 ECU_ADDRESS 0xB0000320 /begin FUNCTION_LIST Foreground /end FUNCTION_LIST /end MEASUREMENT
/begin MEASUREMENT fault_lowFlowRate "" UBYTE COMPU_METHOD__7 0 0 0 1 ECU_ADDRESS 0xB000031F /begin FUNCTION_LIST Foreground /end FUNCTION_LIST /end MEASUREMENT
/begin MEASUREMENT fault_tempSenseHigh "" UBYTE COMPU_METHOD__7 0 0 0 1 ECU_ADDRESS 0xB000031D /begin FUNCTION_LIST Foreground /end FUNCTION_LIST /end MEASUREMENT
/begin MEASUREMENT fault_tempSenseOC "" UBYTE COMPU_METHOD__7 0 0 0 1 ECU_ADDRESS 0xB000031B /begin FUNCTION_LIST Foreground /end FUNCTION_LIST /end MEASUREMENT
/begin MEASUREMENT fault_tempSenseSC "" UBYTE COMPU_METHOD__7 0 0 0 1 ECU_ADDRESS 0xB000031C /begin FUNCTION_LIST Foreground /end FUNCTION_LIST /end MEASUREMENT
/begin MEASUREMENT FgndTasksStopped "Boolean indicating foreground tasks stopped" UBYTE COMPU_METHOD__1 0 0 0 1 ECU_ADDRESS 0xB00002D1 /begin FUNCTION_LIST PowerUp_Down /end FUNCTION_LIST /end MEASUREMENT
/begin MEASUREMENT Flow_rate_freq_corrected "" ULONG COMPU_METHOD__7 0 0 0 4294967295 ECU_ADDRESS 0xB0000358 /begin FUNCTION_LIST Foreground /end FUNCTION_LIST /end MEASUREMENT
/begin MEASUREMENT Flow_rate_gpm "" ULONG COMPU_METHOD__7 0 0 0 4294967295 ECU_ADDRESS 0xB000035C /begin FUNCTION_LIST Foreground /end FUNCTION_LIST /end MEASUREMENT
/begin MEASUREMENT GLV_Battery_Charge "" FLOAT32_IEEE COMPU_METHOD__2 0 0 -1E+17 1E+17 ECU_ADDRESS 0x800380AC /begin FUNCTION_LIST Raise_Startup_Event /end FUNCTION_LIST /end MEASUREMENT
/begin MEASUREMENT GLV_hall_adc "" UWORD COMPU_METHOD__7 0 0 0 65535 ECU_ADDRESS 0xB0000350 /begin FUNCTION_LIST Foreground /end FUNCTION_LIST /end MEASUREMENT
/begin MEASUREMENT GLV_hall_amp "" FLOAT32_IEEE COMPU_METHOD__2 0 0 -1E+17 1E+17 ECU_ADDRESS 0xB0000354 /begin FUNCTION_LIST Foreground /end FUNCTION_LIST /end MEASUREMENT
/begin MEASUREMENT IMD_GLV_probe "" UBYTE COMPU_METHOD__7 0 0 0 1 ECU_ADDRESS 0xB000032C /begin FUNCTION_LIST Foreground /end FUNCTION_LIST /end MEASUREMENT
/begin MEASUREMENT IMD_OkHs_probe "" UBYTE COMPU_METHOD__7 0 0 0 1 ECU_ADDRESS 0xB000032B /begin FUNCTION_LIST Foreground /end FUNCTION_LIST /end MEASUREMENT
/begin MEASUREMENT KeepModuleOn "Boolean indicating module to be kept on" UBYTE COMPU_METHOD__1 0 0 0 1 ECU_ADDRESS 0xB00002D9 /begin FUNCTION_LIST PowerUp_Down /end FUNCTION_LIST /end MEASUREMENT
/begin MEASUREMENT KeySw_Bgnd "Key switch reading from background task" UBYTE COMPU_METHOD__1 0 0 0 1 ECU_ADDRESS 0xB00002D8 /begin FUNCTION_LIST PowerUp_Down /end FUNCTION_LIST /end MEASUREMENT
/begin MEASUREMENT MaxContextSaveAreaSize "Maximum % System Context Save Area Consumption." UWORD COMPU_METHOD__27 0 0 0 99.9985458 ECU_ADDRESS 0xD000A1FA /begin FUNCTION_LIST Platform /end FUNCTION_LIST /end MEASUREMENT
/begin MEASUREMENT MaxSystemStackSize "Maximum % System Stack Consumption." UWORD COMPU_METHOD__27 0 0 0 99.9985458 ECU_ADDRESS 0xD000A1FC /begin FUNCTION_LIST Platform /end FUNCTION_LIST /end MEASUREMENT
/begin MEASUREMENT MaxUserStackSize "Maximum % User Stack Consumption." UWORD COMPU_METHOD__27 0 0 0 99.9985458 ECU_ADDRESS 0xD000A1FE /begin FUNCTION_LIST Platform /end FUNCTION_LIST /end MEASUREMENT
/begin MEASUREMENT NumberOfResetsSincePowerOnReset "The number of resets since the last PowerOn Reset." UBYTE COMPU_METHOD__26 0 0 0 255 ECU_ADDRESS 0xD000258B /begin FUNCTION_LIST Platform /end FUNCTION_LIST /end MEASUREMENT
/begin MEASUREMENT OCWDA_stWDAPtt "Status information for diagnosis module to report reason of WDA activation." ULONG COMPU_METHOD__24 0 0 0 255 ECU_ADDRESS 0xD0002380 /begin FUNCTION_LIST Platform /end FUNCTION_LIST /end MEASUREMENT
/begin MEASUREMENT POT1 "" FLOAT32_IEEE COMPU_METHOD__2 0 0 -1E+17 1E+17 ECU_ADDRESS 0xB00002F0 /begin FUNCTION_LIST Override_2_ /end FUNCTION_LIST /end MEASUREMENT
/begin MEASUREMENT POT1_ADC "" UWORD COMPU_METHOD__7 0 0 0 65535 ECU_ADDRESS 0xB00002EE /begin FUNCTION_LIST Override_2_ /end FUNCTION_LIST /end MEASUREMENT
/begin MEASUREMENT POT1_ADC_Raw "" UWORD COMPU_METHOD__7 0 0 0 65535 ECU_ADDRESS 0xB0000344 /begin FUNCTION_LIST POT1 /end FUNCTION_LIST /end MEASUREMENT
/begin MEASUREMENT POT1_InputHi_Override "" UBYTE COMPU_METHOD__7 0 0 0 1 ECU_ADDRESS 0xB00002EC /begin FUNCTION_LIST Override_2_ /end FUNCTION_LIST /end MEASUREMENT
/begin MEASUREMENT POT1_InputLow_Override "" UBYTE COMPU_METHOD__7 0 0 0 1 ECU_ADDRESS 0xB00002ED /begin FUNCTION_LIST Override_2_ /end FUNCTION_LIST /end MEASUREMENT
/begin MEASUREMENT POT1HighProbe "" UBYTE COMPU_METHOD__7 0 0 0 1 ECU_ADDRESS 0xB0000342 /begin FUNCTION_LIST POT1 /end FUNCTION_LIST /end MEASUREMENT
/begin MEASUREMENT POT1LowProbe "" UBYTE COMPU_METHOD__7 0 0 0 1 ECU_ADDRESS 0xB0000343 /begin FUNCTION_LIST POT1 /end FUNCTION_LIST /end MEASUREMENT
/begin MEASUREMENT POT2 "" FLOAT32_IEEE COMPU_METHOD__2 0 0 -1E+17 1E+17 ECU_ADDRESS 0xB00002F8 /begin FUNCTION_LIST Override_3_ /end FUNCTION_LIST /end MEASUREMENT
/begin MEASUREMENT POT2_ADC "" UWORD COMPU_METHOD__7 0 0 0 65535 ECU_ADDRESS 0xB00002F6 /begin FUNCTION_LIST Override_3_ /end FUNCTION_LIST /end MEASUREMENT
/begin MEASUREMENT POT2_ADC_Raw "" UWORD COMPU_METHOD__7 0 0 0 65535 ECU_ADDRESS 0xB0000348 /begin FUNCTION_LIST POT2 /end FUNCTION_LIST /end MEASUREMENT
/begin MEASUREMENT POT2_InputHi_Override "" UBYTE COMPU_METHOD__7 0 0 0 1 ECU_ADDRESS 0xB00002F4 /begin FUNCTION_LIST Override_3_ /end FUNCTION_LIST /end MEASUREMENT
/begin MEASUREMENT POT2_InputLow_Override "" UBYTE COMPU_METHOD__7 0 0 0 1 ECU_ADDRESS 0xB00002F5 /begin FUNCTION_LIST Override_3_ /end FUNCTION_LIST /end MEASUREMENT
/begin MEASUREMENT POT2HighProbe "" UBYTE COMPU_METHOD__7 0 0 0 1 ECU_ADDRESS 0xB0000346 /begin FUNCTION_LIST POT2 /end FUNCTION_LIST /end MEASUREMENT
/begin MEASUREMENT POT2LowProbe "" UBYTE COMPU_METHOD__7 0 0 0 1 ECU_ADDRESS 0xB0000347 /begin FUNCTION_LIST POT2 /end FUNCTION_LIST /end MEASUREMENT
/begin MEASUREMENT Precharge_status "" UBYTE COMPU_METHOD__7 0 0 0 1 ECU_ADDRESS 0xB000030C /begin FUNCTION_LIST Foreground /end FUNCTION_LIST /end MEASUREMENT
/begin MEASUREMENT Reset_xHistBuf "Reset History." UWORD COMPU_METHOD__23 0 0 0 255 ECU_ADDRESS 0xD000E148 MATRIX_DIM 1 8 1 /begin FUNCTION_LIST Platform /end FUNCTION_LIST /end MEASUREMENT
/begin MEASUREMENT ResetGroupId "The last reset reason group id." UBYTE COMPU_METHOD__25 0 0 0 255 ECU_ADDRESS 0xD000258A /begin FUNCTION_LIST Platform /end FUNCTION_LIST /end MEASUREMENT
/begin MEASUREMENT ResetReason "The last reset reason." UWORD COMPU_METHOD__23 0 0 0 65535 ECU_ADDRESS 0xD0002588 /begin FUNCTION_LIST Platform /end FUNCTION_LIST /end MEASUREMENT
/begin MEASUREMENT RPM_IN "Input for RPM" FLOAT32_IEEE COMPU_METHOD__2 0 0 -1E+17 1E+17 ECU_ADDRESS 0xB00002FC /begin FUNCTION_LIST Calculate_Torque /end FUNCTION_LIST /end MEASUREMENT
/begin MEASUREMENT RPM_val "" FLOAT32_IEEE COMPU_METHOD__2 0 0 -1E+17 1E+17 ECU_ADDRESS 0xB0000330 /begin FUNCTION_LIST Foreground /end FUNCTION_LIST /end MEASUREMENT
/begin MEASUREMENT RTDS "" UBYTE COMPU_METHOD__7 0 0 0 1 ECU_ADDRESS 0xB000030F /begin FUNCTION_LIST Foreground /end FUNCTION_LIST /end MEASUREMENT
/begin MEASUREMENT Safety_loop_error_logic "" UBYTE COMPU_METHOD__7 0 0 0 1 ECU_ADDRESS 0xB000030E /begin FUNCTION_LIST Foreground /end FUNCTION_LIST /end MEASUREMENT
/begin MEASUREMENT Session_Used_Ah "" FLOAT32_IEEE COMPU_METHOD__2 0 0 -1E+17 1E+17 ECU_ADDRESS 0xB00002E0 /begin FUNCTION_LIST GLV_Used_Ah /end FUNCTION_LIST /end MEASUREMENT
/begin MEASUREMENT Starter_button "" UBYTE COMPU_METHOD__7 0 0 0 1 ECU_ADDRESS 0xB000030D /begin FUNCTION_LIST Foreground /end FUNCTION_LIST /end MEASUREMENT
/begin MEASUREMENT Starter_button_latch_q_naught "" UBYTE COMPU_METHOD__7 0 0 0 1 ECU_ADDRESS 0xB000031A /begin FUNCTION_LIST Foreground /end FUNCTION_LIST /end MEASUREMENT
/begin MEASUREMENT Startup_Charge "" FLOAT32_IEEE COMPU_METHOD__2 0 0 -1E+17 1E+17 ECU_ADDRESS 0xB00002D4 /begin FUNCTION_LIST Raise_Startup_Event /end FUNCTION_LIST /end MEASUREMENT
/begin MEASUREMENT SystemStackSize "Current % System Stack Consumption." UWORD COMPU_METHOD__27 0 0 0 99.9985458 ECU_ADDRESS 0xD000A1F6 /begin FUNCTION_LIST Platform /end FUNCTION_LIST /end MEASUREMENT
/begin MEASUREMENT Temp_actual_celsius "" FLOAT32_IEEE COMPU_METHOD__2 0 0 -1E+17 1E+17 ECU_ADDRESS 0xB0000324 /begin FUNCTION_LIST Foreground /end FUNCTION_LIST /end MEASUREMENT
/begin MEASUREMENT Temp_adc_raw "" UWORD COMPU_METHOD__7 0 0 0 65535 ECU_ADDRESS 0xB0000310 /begin FUNCTION_LIST Foreground /end FUNCTION_LIST /end MEASUREMENT
/begin MEASUREMENT Temp_resistance "" FLOAT32_IEEE COMPU_METHOD__2 0 0 -1E+17 1E+17 ECU_ADDRESS 0xB0000314 /begin FUNCTION_LIST Foreground /end FUNCTION_LIST /end MEASUREMENT
/begin MEASUREMENT Throttle_plausibility_probe "" UBYTE COMPU_METHOD__7 0 0 0 1 ECU_ADDRESS 0xB0000340 /begin FUNCTION_LIST Foreground /end FUNCTION_LIST /end MEASUREMENT
/begin MEASUREMENT Torque_cmd "" FLOAT32_IEEE COMPU_METHOD__2 0 0 -1E+17 1E+17 ECU_ADDRESS 0xB0000304 /begin FUNCTION_LIST Command_Troque /end FUNCTION_LIST /end MEASUREMENT
/begin MEASUREMENT TP_val "" FLOAT32_IEEE COMPU_METHOD__2 0 0 -1E+17 1E+17 ECU_ADDRESS 0xB0000334 /begin FUNCTION_LIST Foreground /end FUNCTION_LIST /end MEASUREMENT
/begin MEASUREMENT TSMS_logic_probe "" UBYTE COMPU_METHOD__7 0 0 0 1 ECU_ADDRESS 0xB000032A /begin FUNCTION_LIST Foreground /end FUNCTION_LIST /end MEASUREMENT
/begin MEASUREMENT Used_Ah "" FLOAT32_IEEE COMPU_METHOD__2 0 0 -1E+17 1E+17 ECU_ADDRESS 0xB00002E8 /begin FUNCTION_LIST GLV_Used_Ah /end FUNCTION_LIST /end MEASUREMENT
/begin MEASUREMENT UserStackSize "Current % User Stack Consumption." UWORD COMPU_METHOD__27 0 0 0 99.9985458 ECU_ADDRESS 0xD000A1F8 /begin FUNCTION_LIST Platform /end FUNCTION_LIST /end MEASUREMENT
/begin CHARACTERISTIC APP_default_err_override_OvrSts "Controls status of value override." VALUE 0x80038008 RECORD_LAYOUT__2 0 COMPU_METHOD__6 0 255 /begin FUNCTION_LIST Override /end FUNCTION_LIST /end CHARACTERISTIC
/begin CHARACTERISTIC APP_default_err_override_OvrVal "" VALUE 0x80038004 RECORD_LAYOUT__1 0 COMPU_METHOD__2 -1E+17 1E+17 /begin FUNCTION_LIST Override /end FUNCTION_LIST /end CHARACTERISTIC
/begin CHARACTERISTIC APP_override_OvrSts "Controls status of value override." VALUE 0x80038000 RECORD_LAYOUT__2 0 COMPU_METHOD__6 0 255 /begin FUNCTION_LIST Override /end FUNCTION_LIST /end CHARACTERISTIC
/begin CHARACTERISTIC APP_override_OvrVal "" VALUE 0x80037FFC RECORD_LAYOUT__1 0 COMPU_METHOD__2 -1E+17 1E+17 /begin FUNCTION_LIST Override /end FUNCTION_LIST /end CHARACTERISTIC
/begin CHARACTERISTIC APP1_override_OvrSts "Controls status of value override." VALUE 0x80038028 RECORD_LAYOUT__2 0 COMPU_METHOD__6 0 255 /begin FUNCTION_LIST Override /end FUNCTION_LIST /end CHARACTERISTIC
/begin CHARACTERISTIC APP1_override_OvrVal "" VALUE 0x80038024 RECORD_LAYOUT__1 0 COMPU_METHOD__2 -1E+17 1E+17 /begin FUNCTION_LIST Override /end FUNCTION_LIST /end CHARACTERISTIC
/begin CHARACTERISTIC APP2_override_OvrSts "Controls status of value override." VALUE 0x80038040 RECORD_LAYOUT__2 0 COMPU_METHOD__6 0 255 /begin FUNCTION_LIST Override /end FUNCTION_LIST /end CHARACTERISTIC
/begin CHARACTERISTIC APP2_override_OvrVal "" VALUE 0x8003803C RECORD_LAYOUT__1 0 COMPU_METHOD__2 -1E+17 1E+17 /begin FUNCTION_LIST Override /end FUNCTION_LIST /end CHARACTERISTIC
/begin CHARACTERISTIC BMS_SOC_raw_override_OvrSts "Controls status of value override." VALUE 0x800380A0 RECORD_LAYOUT__2 0 COMPU_METHOD__6 0 255 /begin FUNCTION_LIST Override /end FUNCTION_LIST /end CHARACTERISTIC
/begin CHARACTERISTIC BMS_SOC_raw_override_OvrVal "" VALUE 0x8003809E RECORD_LAYOUT__3 0 COMPU_METHOD__7 0 65535 /begin FUNCTION_LIST Override /end FUNCTION_LIST /end CHARACTERISTIC
/begin CHARACTERISTIC BuildNumber "Model build number." VALUE 0x8003829C RECORD_LAYOUT__5 0 COMPU_METHOD__16 0 4294967295 READ_ONLY /end CHARACTERISTIC
/begin CHARACTERISTIC BuildUID "Unique build ID for this software." ASCII 0x800382E3 RECORD_LAYOUT__2 0 COMPU_METHOD__16 0 255 READ_ONLY MATRIX_DIM 21 1 1 /end CHARACTERISTIC
/begin CHARACTERISTIC CalIdTxt "Calibration ID for this Software Package." ASCII 0x800382D0 RECORD_LAYOUT__2 0 COMPU_METHOD__16 0 255 MATRIX_DIM 19 1 1 /end CHARACTERISTIC
/begin CHARACTERISTIC CAN1_ErrorCheck_Interval "Frequency interval to check for CAN errors, 0 to disable." VALUE 0x8003825A RECORD_LAYOUT__2 0 COMPU_METHOD__20 0 255 /begin FUNCTION_LIST CAN /end FUNCTION_LIST /end CHARACTERISTIC
/begin CHARACTERISTIC CAN1_ErrorPassive_Delay "Delay before restart after Error passive detected." VALUE 0x8003825B RECORD_LAYOUT__2 0 COMPU_METHOD__20 0 255 /begin FUNCTION_LIST CAN /end FUNCTION_LIST /end CHARACTERISTIC
/begin CHARACTERISTIC CAN1_Startup_Delay "Delay before starting send/receive to allow bus conditions to settle out after powerup." VALUE 0x80038258 RECORD_LAYOUT__3 0 COMPU_METHOD__20 20 60000 /begin FUNCTION_LIST CAN /end FUNCTION_LIST /end CHARACTERISTIC
/begin CHARACTERISTIC CAN2_ErrorCheck_Interval "Frequency interval to check for CAN errors, 0 to disable." VALUE 0x8003825E RECORD_LAYOUT__2 0 COMPU_METHOD__20 0 255 /begin FUNCTION_LIST CAN /end FUNCTION_LIST /end CHARACTERISTIC
/begin CHARACTERISTIC CAN2_ErrorPassive_Delay "Delay before restart after Error passive detected." VALUE 0x8003825F RECORD_LAYOUT__2 0 COMPU_METHOD__20 0 255 /begin FUNCTION_LIST CAN /end FUNCTION_LIST /end CHARACTERISTIC
/begin CHARACTERISTIC CAN2_Startup_Delay "Delay before starting send/receive to allow bus conditions to settle out after powerup." VALUE 0x8003825C RECORD_LAYOUT__3 0 COMPU_METHOD__20 20 60000 /begin FUNCTION_LIST CAN /end FUNCTION_LIST /end CHARACTERISTIC
/begin CHARACTERISTIC Charge_mode_raw_override_OvrSts "Controls status of value override." VALUE 0x8003804C RECORD_LAYOUT__2 0 COMPU_METHOD__6 0 255 /begin FUNCTION_LIST Override /end FUNCTION_LIST /end CHARACTERISTIC
/begin CHARACTERISTIC Charge_mode_raw_override_OvrVal "" VALUE 0x8003804B RECORD_LAYOUT__2 0 COMPU_METHOD__7 0 1 /begin FUNCTION_LIST Override /end FUNCTION_LIST /end CHARACTERISTIC
/begin CHARACTERISTIC Cooling_fault_any_override_OvrSts "Controls status of value override." VALUE 0x8003804E RECORD_LAYOUT__2 0 COMPU_METHOD__6 0 255 /begin FUNCTION_LIST Override /end FUNCTION_LIST /end CHARACTERISTIC
/begin CHARACTERISTIC Cooling_fault_any_override_OvrVal "" VALUE 0x8003804D RECORD_LAYOUT__2 0 COMPU_METHOD__7 0 1 /begin FUNCTION_LIST Override /end FUNCTION_LIST /end CHARACTERISTIC
/begin CHARACTERISTIC Cooling_pump_PWM_D "Temp at 80W" VALUE 0x800380CC RECORD_LAYOUT__1 0 COMPU_METHOD__5 -1E+17 1E+17 /begin FUNCTION_LIST Foreground /end FUNCTION_LIST /end CHARACTERISTIC
/begin CHARACTERISTIC DateStamp "Date and time the model was built." ASCII 0x80038300 RECORD_LAYOUT__2 0 COMPU_METHOD__16 0 255 READ_ONLY MATRIX_DIM 20 1 1 /end CHARACTERISTIC
/begin CHARACTERISTIC Direction_cmd_override_OvrSts "Controls status of value override." VALUE 0x80038010 RECORD_LAYOUT__2 0 COMPU_METHOD__6 0 255 /begin FUNCTION_LIST Override_1_ /end FUNCTION_LIST /end CHARACTERISTIC
/begin CHARACTERISTIC Direction_cmd_override_OvrVal "" VALUE 0x8003800C RECORD_LAYOUT__1 0 COMPU_METHOD__2 -1E+17 1E+17 /begin FUNCTION_LIST Override_1_ /end FUNCTION_LIST /end CHARACTERISTIC
/begin CHARACTERISTIC Drive_enable_override_OvrSts "Controls status of value override." VALUE 0x80038050 RECORD_LAYOUT__2 0 COMPU_METHOD__6 0 255 /begin FUNCTION_LIST Override /end FUNCTION_LIST /end CHARACTERISTIC
/begin CHARACTERISTIC Drive_enable_override_OvrVal "" VALUE 0x8003804F RECORD_LAYOUT__2 0 COMPU_METHOD__7 0 1 /begin FUNCTION_LIST Override /end FUNCTION_LIST /end CHARACTERISTIC
/begin CHARACTERISTIC EndOfStart "Indicates whether start is completed." VALUE 0x8003826C RECORD_LAYOUT__2 0 COMPU_METHOD__28 0 255 /begin FUNCTION_LIST Platform /end FUNCTION_LIST /end CHARACTERISTIC
/begin CHARACTERISTIC eradicFlow_FaultOperation "Calibration for testing fault." VALUE 0x80038265 RECORD_LAYOUT__2 0 COMPU_METHOD__21 0 8 /begin FUNCTION_LIST FaultManager /end FUNCTION_LIST /end CHARACTERISTIC
/begin CHARACTERISTIC eradicFlow_X_Limit "Limit threshold for X." VALUE 0x80038240 RECORD_LAYOUT__5 0 COMPU_METHOD__12 0 4294967295 /begin FUNCTION_LIST FaultManager /end FUNCTION_LIST /end CHARACTERISTIC
/begin CHARACTERISTIC eradicFlow_Y_Limit "Limit threshold for Y." VALUE 0x80038244 RECORD_LAYOUT__5 0 COMPU_METHOD__12 0 4294967295 /begin FUNCTION_LIST FaultManager /end FUNCTION_LIST /end CHARACTERISTIC
/begin CHARACTERISTIC eradicFlowRateFault "" VALUE 0x8003823C RECORD_LAYOUT__1 0 COMPU_METHOD__15 -1E+17 1E+17 /begin FUNCTION_LIST Foreground /end FUNCTION_LIST /end CHARACTERISTIC
/begin CHARACTERISTIC eradicTemp_FaultOperation "Calibration for testing fault." VALUE 0x80038266 RECORD_LAYOUT__2 0 COMPU_METHOD__21 0 8 /begin FUNCTION_LIST FaultManager /end FUNCTION_LIST /end CHARACTERISTIC
/begin CHARACTERISTIC eradicTemp_X_Limit "Limit threshold for X." VALUE 0x800381E0 RECORD_LAYOUT__5 0 COMPU_METHOD__12 0 4294967295 /begin FUNCTION_LIST FaultManager /end FUNCTION_LIST /end CHARACTERISTIC
/begin CHARACTERISTIC eradicTemp_Y_Limit "Limit threshold for Y." VALUE 0x800381E4 RECORD_LAYOUT__5 0 COMPU_METHOD__12 0 4294967295 /begin FUNCTION_LIST FaultManager /end FUNCTION_LIST /end CHARACTERISTIC
/begin CHARACTERISTIC Fan_PWM_D_override_OvrSts "Controls status of value override." VALUE 0x80038088 RECORD_LAYOUT__2 0 COMPU_METHOD__6 0 255 /begin FUNCTION_LIST Override /end FUNCTION_LIST /end CHARACTERISTIC
/begin CHARACTERISTIC Fan_PWM_D_override_OvrVal "" VALUE 0x80038086 RECORD_LAYOUT__3 0 COMPU_METHOD__7 0 65535 /begin FUNCTION_LIST Override /end FUNCTION_LIST /end CHARACTERISTIC
/begin CHARACTERISTIC Fan_PWM_freq "" VALUE 0x80038208 RECORD_LAYOUT__5 0 COMPU_METHOD__13 0 429496729500 /begin FUNCTION_LIST Foreground /end FUNCTION_LIST /end CHARACTERISTIC
/begin CHARACTERISTIC Flow_rate_gpm_override_OvrSts "Controls status of value override." VALUE 0x8003809C RECORD_LAYOUT__2 0 COMPU_METHOD__6 0 255 /begin FUNCTION_LIST Override /end FUNCTION_LIST /end CHARACTERISTIC
/begin CHARACTERISTIC Flow_rate_gpm_override_OvrVal "" VALUE 0x80038098 RECORD_LAYOUT__5 0 COMPU_METHOD__7 0 4294967295 /begin FUNCTION_LIST Override /end FUNCTION_LIST /end CHARACTERISTIC
/begin CHARACTERISTIC Flowrate_hz_corrected_override_OvrSts "Controls status of value override." VALUE 0x80038094 RECORD_LAYOUT__2 0 COMPU_METHOD__6 0 255 /begin FUNCTION_LIST Override /end FUNCTION_LIST /end CHARACTERISTIC
/begin CHARACTERISTIC Flowrate_hz_corrected_override_OvrVal "" VALUE 0x80038090 RECORD_LAYOUT__5 0 COMPU_METHOD__7 0 4294967295 /begin FUNCTION_LIST Override /end FUNCTION_LIST /end CHARACTERISTIC
/begin CHARACTERISTIC GLV_hall_out_raw_override_OvrSts "Controls status of value override." VALUE 0x8003808C RECORD_LAYOUT__2 0 COMPU_METHOD__6 0 255 /begin FUNCTION_LIST Override /end FUNCTION_LIST /end CHARACTERISTIC
/begin CHARACTERISTIC GLV_hall_out_raw_override_OvrVal "" VALUE 0x8003808A RECORD_LAYOUT__3 0 COMPU_METHOD__7 0 65535 /begin FUNCTION_LIST Override /end FUNCTION_LIST /end CHARACTERISTIC
/begin CHARACTERISTIC HardwareType "Hardware type for the target." VALUE 0x800382FC RECORD_LAYOUT__5 0 COMPU_METHOD__16 0 4294967295 READ_ONLY /end CHARACTERISTIC
/begin CHARACTERISTIC IdTableRev "IdTableRev for the model (XCP device ids)." VALUE 0x800382F8 RECORD_LAYOUT__3 0 COMPU_METHOD__16 0 65535 READ_ONLY /end CHARACTERISTIC
/begin CHARACTERISTIC IMD_GLV_override_OvrSts "Controls status of value override." VALUE 0x80038070 RECORD_LAYOUT__2 0 COMPU_METHOD__6 0 255 /begin FUNCTION_LIST Override /end FUNCTION_LIST /end CHARACTERISTIC
/begin CHARACTERISTIC IMD_GLV_override_OvrVal "" VALUE 0x8003806F RECORD_LAYOUT__2 0 COMPU_METHOD__7 0 1 /begin FUNCTION_LIST Override /end FUNCTION_LIST /end CHARACTERISTIC
/begin CHARACTERISTIC IMD_OkHs_override_OvrSts "Controls status of value override." VALUE 0x80038072 RECORD_LAYOUT__2 0 COMPU_METHOD__6 0 255 /begin FUNCTION_LIST Override /end FUNCTION_LIST /end CHARACTERISTIC
/begin CHARACTERISTIC IMD_OkHs_override_OvrVal "" VALUE 0x80038071 RECORD_LAYOUT__2 0 COMPU_METHOD__7 0 1 /begin FUNCTION_LIST Override /end FUNCTION_LIST /end CHARACTERISTIC
/begin CHARACTERISTIC InjCDrv_EndOfStart "Indicates end of start for injection. Engine start is completed." VALUE 0x8003826B RECORD_LAYOUT__2 0 COMPU_METHOD__28 0 255 /begin FUNCTION_LIST Fuel /end FUNCTION_LIST /end CHARACTERISTIC
/begin CHARACTERISTIC INPUT29_ADCMon_HoldCount "Number of samples to hold after ADC monitor check." VALUE 0x80038254 RECORD_LAYOUT__2 0 COMPU_METHOD__17 0 255 /begin FUNCTION_LIST Platform /end FUNCTION_LIST /end CHARACTERISTIC
/begin CHARACTERISTIC Inverter_enb_override_OvrSts "Controls status of value override." VALUE 0x80038052 RECORD_LAYOUT__2 0 COMPU_METHOD__6 0 255 /begin FUNCTION_LIST Override_1_ /end FUNCTION_LIST /end CHARACTERISTIC
/begin CHARACTERISTIC Inverter_enb_override_OvrVal "" VALUE 0x80038051 RECORD_LAYOUT__2 0 COMPU_METHOD__7 0 1 /begin FUNCTION_LIST Override_1_ /end FUNCTION_LIST /end CHARACTERISTIC
/begin CHARACTERISTIC KeySwHiTimeThr "State high time threshold" VALUE 0x800380BC RECORD_LAYOUT__1 0 COMPU_METHOD__3 -1E+17 1E+17 /begin FUNCTION_LIST PowerUp_Down /end FUNCTION_LIST /end CHARACTERISTIC
/begin CHARACTERISTIC KeySwLoTimeThr "State low time threshold" VALUE 0x800380C0 RECORD_LAYOUT__1 0 COMPU_METHOD__3 -1E+17 1E+17 /begin FUNCTION_LIST PowerUp_Down /end FUNCTION_LIST /end CHARACTERISTIC
/begin CHARACTERISTIC LowerFanPoint "Temp at 0W" VALUE 0x800380C8 RECORD_LAYOUT__1 0 COMPU_METHOD__5 -1E+17 1E+17 /begin FUNCTION_LIST Foreground /end FUNCTION_LIST /end CHARACTERISTIC
/begin CHARACTERISTIC lowFlowRate_FaultOperation "Calibration for testing fault." VALUE 0x80038267 RECORD_LAYOUT__2 0 COMPU_METHOD__21 0 8 /begin FUNCTION_LIST FaultManager /end FUNCTION_LIST /end CHARACTERISTIC
/begin CHARACTERISTIC lowFlowRate_X_Limit "Limit threshold for X." VALUE 0x80038234 RECORD_LAYOUT__5 0 COMPU_METHOD__12 0 4294967295 /begin FUNCTION_LIST FaultManager /end FUNCTION_LIST /end CHARACTERISTIC
/begin CHARACTERISTIC lowFlowRate_Y_Limit "Limit threshold for Y." VALUE 0x80038238 RECORD_LAYOUT__5 0 COMPU_METHOD__12 0 4294967295 /begin FUNCTION_LIST FaultManager /end FUNCTION_LIST /end CHARACTERISTIC
/begin CHARACTERISTIC lowFlowRateFault "" VALUE 0x80038230 RECORD_LAYOUT__1 0 COMPU_METHOD__14 -1E+17 1E+17 /begin FUNCTION_LIST Foreground /end FUNCTION_LIST /end CHARACTERISTIC
/begin CHARACTERISTIC MatlabVersion "Matlab version used for build." ASCII 0x800382A0 RECORD_LAYOUT__2 0 COMPU_METHOD__16 0 255 READ_ONLY MATRIX_DIM 13 1 1 /end CHARACTERISTIC
/begin CHARACTERISTIC MaxTorqueMap "" CURVE 0x80038158 RECORD_LAYOUT__1 0 COMPU_METHOD__10 -1E+17 1E+17
 /begin AXIS_DESCR COM_AXIS /*InputQuantity*/ RPM_IN COMPU_METHOD__9 /*MaxAxisPoints*/ 33 /*LowerLimit */ -1E+17 /*UpperLimit */ 1E+17 /*Axis Ref */ AXIS_PTS_REF RPM /end AXIS_DESCR
 /begin FUNCTION_LIST Calculate_Torque /end FUNCTION_LIST
/end CHARACTERISTIC
/begin CHARACTERISTIC ModelName "Name of model" ASCII 0x80038290 RECORD_LAYOUT__2 0 COMPU_METHOD__16 0 255 READ_ONLY MATRIX_DIM 11 1 1 /end CHARACTERISTIC
/begin CHARACTERISTIC POT1_ADC_OvrSts "Controls status of value override." VALUE 0x80038018 RECORD_LAYOUT__2 0 COMPU_METHOD__6 0 255 /begin FUNCTION_LIST Override_2_ /end FUNCTION_LIST /end CHARACTERISTIC
/begin CHARACTERISTIC POT1_ADC_OvrVal "" VALUE 0x80038016 RECORD_LAYOUT__3 0 COMPU_METHOD__7 0 65535 /begin FUNCTION_LIST Override_2_ /end FUNCTION_LIST /end CHARACTERISTIC
/begin CHARACTERISTIC POT1_ADCHiPT "ADC High Point" VALUE 0x80038270 RECORD_LAYOUT__1 0 COMPU_METHOD__8 -1E+17 1E+17 /begin FUNCTION_LIST POT1 /end FUNCTION_LIST /end CHARACTERISTIC
/begin CHARACTERISTIC POT1_ADCLoPT "ADC Low Point" VALUE 0x80038274 RECORD_LAYOUT__1 0 COMPU_METHOD__8 -1E+17 1E+17 /begin FUNCTION_LIST POT1 /end FUNCTION_LIST /end CHARACTERISTIC
/begin CHARACTERISTIC POT1_InputHi_FaultOperation "Calibration for testing fault." VALUE 0x80038260 RECORD_LAYOUT__2 0 COMPU_METHOD__21 0 8 /begin FUNCTION_LIST FaultManager /end FUNCTION_LIST /end CHARACTERISTIC
/begin CHARACTERISTIC POT1_InputHi_Override_OvrSts "Controls status of value override." VALUE 0x80038012 RECORD_LAYOUT__2 0 COMPU_METHOD__6 0 255 /begin FUNCTION_LIST Override_2_ /end FUNCTION_LIST /end CHARACTERISTIC
/begin CHARACTERISTIC POT1_InputHi_Override_OvrVal "" VALUE 0x80038011 RECORD_LAYOUT__2 0 COMPU_METHOD__7 0 1 /begin FUNCTION_LIST Override_2_ /end FUNCTION_LIST /end CHARACTERISTIC
/begin CHARACTERISTIC POT1_InputHi_X_Limit "Limit threshold for X." VALUE 0x80038210 RECORD_LAYOUT__5 0 COMPU_METHOD__12 0 4294967295 /begin FUNCTION_LIST FaultManager /end FUNCTION_LIST /end CHARACTERISTIC
/begin CHARACTERISTIC POT1_InputHi_Y_Limit "Limit threshold for Y." VALUE 0x80038214 RECORD_LAYOUT__5 0 COMPU_METHOD__12 0 4294967295 /begin FUNCTION_LIST FaultManager /end FUNCTION_LIST /end CHARACTERISTIC
/begin CHARACTERISTIC POT1_InputHighThresh "Input out of range high point threshold" VALUE 0x80038280 RECORD_LAYOUT__1 0 COMPU_METHOD__8 -1E+17 1E+17 /begin FUNCTION_LIST POT1 /end FUNCTION_LIST /end CHARACTERISTIC
/begin CHARACTERISTIC POT1_InputLow_FaultOperation "Calibration for testing fault." VALUE 0x80038261 RECORD_LAYOUT__2 0 COMPU_METHOD__21 0 8 /begin FUNCTION_LIST FaultManager /end FUNCTION_LIST /end CHARACTERISTIC
/begin CHARACTERISTIC POT1_InputLow_Override_OvrSts "Controls status of value override." VALUE 0x80038014 RECORD_LAYOUT__2 0 COMPU_METHOD__6 0 255 /begin FUNCTION_LIST Override_2_ /end FUNCTION_LIST /end CHARACTERISTIC
/begin CHARACTERISTIC POT1_InputLow_Override_OvrVal "" VALUE 0x80038013 RECORD_LAYOUT__2 0 COMPU_METHOD__7 0 1 /begin FUNCTION_LIST Override_2_ /end FUNCTION_LIST /end CHARACTERISTIC
/begin CHARACTERISTIC POT1_InputLow_X_Limit "Limit threshold for X." VALUE 0x80038218 RECORD_LAYOUT__5 0 COMPU_METHOD__12 0 4294967295 /begin FUNCTION_LIST FaultManager /end FUNCTION_LIST /end CHARACTERISTIC
/begin CHARACTERISTIC POT1_InputLow_Y_Limit "Limit threshold for Y." VALUE 0x8003821C RECORD_LAYOUT__5 0 COMPU_METHOD__12 0 4294967295 /begin FUNCTION_LIST FaultManager /end FUNCTION_LIST /end CHARACTERISTIC
/begin CHARACTERISTIC POT1_InputLowThresh "Input out of range low point threshold" VALUE 0x80038284 RECORD_LAYOUT__1 0 COMPU_METHOD__8 -1E+17 1E+17 /begin FUNCTION_LIST POT1 /end FUNCTION_LIST /end CHARACTERISTIC
/begin CHARACTERISTIC POT1_OvrSts "Controls status of value override." VALUE 0x80038020 RECORD_LAYOUT__2 0 COMPU_METHOD__6 0 255 /begin FUNCTION_LIST Override_2_ /end FUNCTION_LIST /end CHARACTERISTIC
/begin CHARACTERISTIC POT1_OvrVal "" VALUE 0x8003801C RECORD_LAYOUT__1 0 COMPU_METHOD__2 -1E+17 1E+17 /begin FUNCTION_LIST Override_2_ /end FUNCTION_LIST /end CHARACTERISTIC
/begin CHARACTERISTIC POT2_ADC_OvrSts "Controls status of value override." VALUE 0x80038030 RECORD_LAYOUT__2 0 COMPU_METHOD__6 0 255 /begin FUNCTION_LIST Override_3_ /end FUNCTION_LIST /end CHARACTERISTIC
/begin CHARACTERISTIC POT2_ADC_OvrVal "" VALUE 0x8003802E RECORD_LAYOUT__3 0 COMPU_METHOD__7 0 65535 /begin FUNCTION_LIST Override_3_ /end FUNCTION_LIST /end CHARACTERISTIC
/begin CHARACTERISTIC POT2_ADCHiPT "ADC High Point" VALUE 0x80038278 RECORD_LAYOUT__1 0 COMPU_METHOD__8 -1E+17 1E+17 /begin FUNCTION_LIST POT2 /end FUNCTION_LIST /end CHARACTERISTIC
/begin CHARACTERISTIC POT2_ADCLoPT "ADC Low Point" VALUE 0x8003827C RECORD_LAYOUT__1 0 COMPU_METHOD__8 -1E+17 1E+17 /begin FUNCTION_LIST POT2 /end FUNCTION_LIST /end CHARACTERISTIC
/begin CHARACTERISTIC POT2_InputHi_FaultOperation "Calibration for testing fault." VALUE 0x80038262 RECORD_LAYOUT__2 0 COMPU_METHOD__21 0 8 /begin FUNCTION_LIST FaultManager /end FUNCTION_LIST /end CHARACTERISTIC
/begin CHARACTERISTIC POT2_InputHi_Override_OvrSts "Controls status of value override." VALUE 0x8003802A RECORD_LAYOUT__2 0 COMPU_METHOD__6 0 255 /begin FUNCTION_LIST Override_3_ /end FUNCTION_LIST /end CHARACTERISTIC
/begin CHARACTERISTIC POT2_InputHi_Override_OvrVal "" VALUE 0x80038029 RECORD_LAYOUT__2 0 COMPU_METHOD__7 0 1 /begin FUNCTION_LIST Override_3_ /end FUNCTION_LIST /end CHARACTERISTIC
/begin CHARACTERISTIC POT2_InputHi_X_Limit "Limit threshold for X." VALUE 0x80038220 RECORD_LAYOUT__5 0 COMPU_METHOD__12 0 4294967295 /begin FUNCTION_LIST FaultManager /end FUNCTION_LIST /end CHARACTERISTIC
/begin CHARACTERISTIC POT2_InputHi_Y_Limit "Limit threshold for Y." VALUE 0x80038224 RECORD_LAYOUT__5 0 COMPU_METHOD__12 0 4294967295 /begin FUNCTION_LIST FaultManager /end FUNCTION_LIST /end CHARACTERISTIC
/begin CHARACTERISTIC POT2_InputHighThresh "Input out of range high point threshold" VALUE 0x80038288 RECORD_LAYOUT__1 0 COMPU_METHOD__8 -1E+17 1E+17 /begin FUNCTION_LIST POT2 /end FUNCTION_LIST /end CHARACTERISTIC
/begin CHARACTERISTIC POT2_InputLow_FaultOperation "Calibration for testing fault." VALUE 0x80038263 RECORD_LAYOUT__2 0 COMPU_METHOD__21 0 8 /begin FUNCTION_LIST FaultManager /end FUNCTION_LIST /end CHARACTERISTIC
/begin CHARACTERISTIC POT2_InputLow_Override_OvrSts "Controls status of value override." VALUE 0x8003802C RECORD_LAYOUT__2 0 COMPU_METHOD__6 0 255 /begin FUNCTION_LIST Override_3_ /end FUNCTION_LIST /end CHARACTERISTIC
/begin CHARACTERISTIC POT2_InputLow_Override_OvrVal "" VALUE 0x8003802B RECORD_LAYOUT__2 0 COMPU_METHOD__7 0 1 /begin FUNCTION_LIST Override_3_ /end FUNCTION_LIST /end CHARACTERISTIC
/begin CHARACTERISTIC POT2_InputLow_X_Limit "Limit threshold for X." VALUE 0x80038228 RECORD_LAYOUT__5 0 COMPU_METHOD__12 0 4294967295 /begin FUNCTION_LIST FaultManager /end FUNCTION_LIST /end CHARACTERISTIC
/begin CHARACTERISTIC POT2_InputLow_Y_Limit "Limit threshold for Y." VALUE 0x8003822C RECORD_LAYOUT__5 0 COMPU_METHOD__12 0 4294967295 /begin FUNCTION_LIST FaultManager /end FUNCTION_LIST /end CHARACTERISTIC
/begin CHARACTERISTIC POT2_InputLowThresh "Input out of range low point threshold" VALUE 0x8003828C RECORD_LAYOUT__1 0 COMPU_METHOD__8 -1E+17 1E+17 /begin FUNCTION_LIST POT2 /end FUNCTION_LIST /end CHARACTERISTIC
/begin CHARACTERISTIC POT2_OvrSts "Controls status of value override." VALUE 0x80038038 RECORD_LAYOUT__2 0 COMPU_METHOD__6 0 255 /begin FUNCTION_LIST Override_3_ /end FUNCTION_LIST /end CHARACTERISTIC
/begin CHARACTERISTIC POT2_OvrVal "" VALUE 0x80038034 RECORD_LAYOUT__1 0 COMPU_METHOD__2 -1E+17 1E+17 /begin FUNCTION_LIST Override_3_ /end FUNCTION_LIST /end CHARACTERISTIC
/begin CHARACTERISTIC Precharge_raw_override_OvrSts "Controls status of value override." VALUE 0x8003804A RECORD_LAYOUT__2 0 COMPU_METHOD__6 0 255 /begin FUNCTION_LIST Override /end FUNCTION_LIST /end CHARACTERISTIC
/begin CHARACTERISTIC Precharge_raw_override_OvrVal "" VALUE 0x80038049 RECORD_LAYOUT__2 0 COMPU_METHOD__7 0 1 /begin FUNCTION_LIST Override /end FUNCTION_LIST /end CHARACTERISTIC
/begin CHARACTERISTIC Pump_PWM_freq "" VALUE 0x8003820C RECORD_LAYOUT__5 0 COMPU_METHOD__13 0 429496729500 /begin FUNCTION_LIST Foreground /end FUNCTION_LIST /end CHARACTERISTIC
/begin CHARACTERISTIC RaptorVersion "Raptor version used for build." ASCII 0x800382AD RECORD_LAYOUT__2 0 COMPU_METHOD__16 0 255 READ_ONLY MATRIX_DIM 20 1 1 /end CHARACTERISTIC
/begin CHARACTERISTIC RPM_override_OvrSts "Controls status of value override." VALUE 0x80038058 RECORD_LAYOUT__2 0 COMPU_METHOD__6 0 255 /begin FUNCTION_LIST Override /end FUNCTION_LIST /end CHARACTERISTIC
/begin CHARACTERISTIC RPM_override_OvrVal "" VALUE 0x80038054 RECORD_LAYOUT__1 0 COMPU_METHOD__2 -1E+17 1E+17 /begin FUNCTION_LIST Override /end FUNCTION_LIST /end CHARACTERISTIC
/begin CHARACTERISTIC RTDS_override_OvrSts "Controls status of value override." VALUE 0x8003806A RECORD_LAYOUT__2 0 COMPU_METHOD__6 0 255 /begin FUNCTION_LIST Override /end FUNCTION_LIST /end CHARACTERISTIC
/begin CHARACTERISTIC RTDS_override_OvrVal "" VALUE 0x80038069 RECORD_LAYOUT__2 0 COMPU_METHOD__7 0 1 /begin FUNCTION_LIST Override /end FUNCTION_LIST /end CHARACTERISTIC
/begin CHARACTERISTIC Safety_loop_error_raw_override_OvrSts "Controls status of value override." VALUE 0x80038046 RECORD_LAYOUT__2 0 COMPU_METHOD__6 0 255 /begin FUNCTION_LIST Override /end FUNCTION_LIST /end CHARACTERISTIC
/begin CHARACTERISTIC Safety_loop_error_raw_override_OvrVal "" VALUE 0x80038044 RECORD_LAYOUT__3 0 COMPU_METHOD__7 0 65535 /begin FUNCTION_LIST Override /end FUNCTION_LIST /end CHARACTERISTIC
/begin CHARACTERISTIC Starter_button_override_OvrSts "Controls status of value override." VALUE 0x80038048 RECORD_LAYOUT__2 0 COMPU_METHOD__6 0 255 /begin FUNCTION_LIST Override /end FUNCTION_LIST /end CHARACTERISTIC
/begin CHARACTERISTIC Starter_button_override_OvrVal "" VALUE 0x80038047 RECORD_LAYOUT__2 0 COMPU_METHOD__7 0 1 /begin FUNCTION_LIST Override /end FUNCTION_LIST /end CHARACTERISTIC
/begin CHARACTERISTIC Starter_button_raw_override_OvrSts "Controls status of value override." VALUE 0x80038042 RECORD_LAYOUT__2 0 COMPU_METHOD__6 0 255 /begin FUNCTION_LIST Override /end FUNCTION_LIST /end CHARACTERISTIC
/begin CHARACTERISTIC Starter_button_raw_override_OvrVal "" VALUE 0x80038041 RECORD_LAYOUT__2 0 COMPU_METHOD__7 0 1 /begin FUNCTION_LIST Override /end FUNCTION_LIST /end CHARACTERISTIC
/begin CHARACTERISTIC SwIdTxt "Software name for this build." ASCII 0x800382C1 RECORD_LAYOUT__2 0 COMPU_METHOD__16 0 255 READ_ONLY MATRIX_DIM 15 1 1 /end CHARACTERISTIC
/begin CHARACTERISTIC SyC_tiPostDrvMax_C "Maximal time in PostDrive state with RPM equal to zero." VALUE 0x80983A6E RECORD_LAYOUT__3 0 COMPU_METHOD__22 0 4000 /begin FUNCTION_LIST Platform /end FUNCTION_LIST /end CHARACTERISTIC
/begin CHARACTERISTIC SyC_tiPostDrvMin_C "Minimum time in PostDrive state with RPM equal to zero." VALUE 0x80983A70 RECORD_LAYOUT__3 0 COMPU_METHOD__22 3 4000 /begin FUNCTION_LIST Platform /end FUNCTION_LIST /end CHARACTERISTIC
/begin CHARACTERISTIC SyC_tiPostDrvResv_C "Reserved time within SyC_PostDrvMax_C for DSM and EEPROM activities at the end of PostDrive." VALUE 0x80983A72 RECORD_LAYOUT__3 0 COMPU_METHOD__22 0 4000 /begin FUNCTION_LIST Platform /end FUNCTION_LIST /end CHARACTERISTIC
/begin CHARACTERISTIC Temp_actual_celsius_override_OvrSts "Controls status of value override." VALUE 0x80038084 RECORD_LAYOUT__2 0 COMPU_METHOD__6 0 255 /begin FUNCTION_LIST Override /end FUNCTION_LIST /end CHARACTERISTIC
/begin CHARACTERISTIC Temp_actual_celsius_override_OvrVal "" VALUE 0x80038080 RECORD_LAYOUT__1 0 COMPU_METHOD__2 -1E+17 1E+17 /begin FUNCTION_LIST Override /end FUNCTION_LIST /end CHARACTERISTIC
/begin CHARACTERISTIC Temp_adc_raw_override_OvrSts "Controls status of value override." VALUE 0x80038076 RECORD_LAYOUT__2 0 COMPU_METHOD__6 0 255 /begin FUNCTION_LIST Override /end FUNCTION_LIST /end CHARACTERISTIC
/begin CHARACTERISTIC Temp_adc_raw_override_OvrVal "" VALUE 0x80038074 RECORD_LAYOUT__3 0 COMPU_METHOD__7 0 65535 /begin FUNCTION_LIST Override /end FUNCTION_LIST /end CHARACTERISTIC
/begin CHARACTERISTIC Temp_resistance_override_OvrSts "Controls status of value override." VALUE 0x8003807C RECORD_LAYOUT__2 0 COMPU_METHOD__6 0 255 /begin FUNCTION_LIST Override /end FUNCTION_LIST /end CHARACTERISTIC
/begin CHARACTERISTIC Temp_resistance_override_OvrVal "" VALUE 0x80038078 RECORD_LAYOUT__1 0 COMPU_METHOD__2 -1E+17 1E+17 /begin FUNCTION_LIST Override /end FUNCTION_LIST /end CHARACTERISTIC
/begin CHARACTERISTIC tempHigh_FaultOperation "Calibration for testing fault." VALUE 0x80038268 RECORD_LAYOUT__2 0 COMPU_METHOD__21 0 8 /begin FUNCTION_LIST FaultManager /end FUNCTION_LIST /end CHARACTERISTIC
/begin CHARACTERISTIC tempHigh_X_Limit "Limit threshold for X." VALUE 0x800381F8 RECORD_LAYOUT__5 0 COMPU_METHOD__12 0 4294967295 /begin FUNCTION_LIST FaultManager /end FUNCTION_LIST /end CHARACTERISTIC
/begin CHARACTERISTIC tempHigh_Y_Limit "Limit threshold for Y." VALUE 0x800381FC RECORD_LAYOUT__5 0 COMPU_METHOD__12 0 4294967295 /begin FUNCTION_LIST FaultManager /end FUNCTION_LIST /end CHARACTERISTIC
/begin CHARACTERISTIC tempRateFault "" VALUE 0x800381DC RECORD_LAYOUT__1 0 COMPU_METHOD__11 -1E+17 1E+17 /begin FUNCTION_LIST Foreground /end FUNCTION_LIST /end CHARACTERISTIC
/begin CHARACTERISTIC tempSenseOC_FaultOperation "Calibration for testing fault." VALUE 0x80038269 RECORD_LAYOUT__2 0 COMPU_METHOD__21 0 8 /begin FUNCTION_LIST FaultManager /end FUNCTION_LIST /end CHARACTERISTIC
/begin CHARACTERISTIC tempSenseOC_X_Limit "Limit threshold for X." VALUE 0x800381E8 RECORD_LAYOUT__5 0 COMPU_METHOD__12 0 4294967295 /begin FUNCTION_LIST FaultManager /end FUNCTION_LIST /end CHARACTERISTIC
/begin CHARACTERISTIC tempSenseOC_Y_Limit "Limit threshold for Y." VALUE 0x800381EC RECORD_LAYOUT__5 0 COMPU_METHOD__12 0 4294967295 /begin FUNCTION_LIST FaultManager /end FUNCTION_LIST /end CHARACTERISTIC
/begin CHARACTERISTIC tempSenseSC_FaultOperation "Calibration for testing fault." VALUE 0x8003826A RECORD_LAYOUT__2 0 COMPU_METHOD__21 0 8 /begin FUNCTION_LIST FaultManager /end FUNCTION_LIST /end CHARACTERISTIC
/begin CHARACTERISTIC tempSenseSC_X_Limit "Limit threshold for X." VALUE 0x800381F0 RECORD_LAYOUT__5 0 COMPU_METHOD__12 0 4294967295 /begin FUNCTION_LIST FaultManager /end FUNCTION_LIST /end CHARACTERISTIC
/begin CHARACTERISTIC tempSenseSC_Y_Limit "Limit threshold for Y." VALUE 0x800381F4 RECORD_LAYOUT__5 0 COMPU_METHOD__12 0 4294967295 /begin FUNCTION_LIST FaultManager /end FUNCTION_LIST /end CHARACTERISTIC
/begin CHARACTERISTIC Throttle_plausibility_FaultOperation "Calibration for testing fault." VALUE 0x80038264 RECORD_LAYOUT__2 0 COMPU_METHOD__21 0 8 /begin FUNCTION_LIST FaultManager /end FUNCTION_LIST /end CHARACTERISTIC
/begin CHARACTERISTIC Throttle_plausibility_X_Limit "Limit threshold for X." VALUE 0x80038200 RECORD_LAYOUT__5 0 COMPU_METHOD__12 0 4294967295 /begin FUNCTION_LIST FaultManager /end FUNCTION_LIST /end CHARACTERISTIC
/begin CHARACTERISTIC Throttle_plausibility_Y_Limit "Limit threshold for Y." VALUE 0x80038204 RECORD_LAYOUT__5 0 COMPU_METHOD__12 0 4294967295 /begin FUNCTION_LIST FaultManager /end FUNCTION_LIST /end CHARACTERISTIC
/begin CHARACTERISTIC Torque_cmd_override_OvrSts "Controls status of value override." VALUE 0x80038068 RECORD_LAYOUT__2 0 COMPU_METHOD__6 0 255 /begin FUNCTION_LIST Override_1_ /end FUNCTION_LIST /end CHARACTERISTIC
/begin CHARACTERISTIC Torque_cmd_override_OvrVal "" VALUE 0x80038064 RECORD_LAYOUT__1 0 COMPU_METHOD__2 -1E+17 1E+17 /begin FUNCTION_LIST Override_1_ /end FUNCTION_LIST /end CHARACTERISTIC
/begin CHARACTERISTIC Torque_map_val_override_OvrSts "Controls status of value override." VALUE 0x80038060 RECORD_LAYOUT__2 0 COMPU_METHOD__6 0 255 /begin FUNCTION_LIST Override /end FUNCTION_LIST /end CHARACTERISTIC
/begin CHARACTERISTIC Torque_map_val_override_OvrVal "" VALUE 0x8003805C RECORD_LAYOUT__1 0 COMPU_METHOD__2 -1E+17 1E+17 /begin FUNCTION_LIST Override /end FUNCTION_LIST /end CHARACTERISTIC
/begin CHARACTERISTIC TSMS_ADC_override_OvrSts "Controls status of value override." VALUE 0x8003806E RECORD_LAYOUT__2 0 COMPU_METHOD__6 0 255 /begin FUNCTION_LIST Override /end FUNCTION_LIST /end CHARACTERISTIC
/begin CHARACTERISTIC TSMS_ADC_override_OvrVal "" VALUE 0x8003806C RECORD_LAYOUT__3 0 COMPU_METHOD__7 0 65535 /begin FUNCTION_LIST Override /end FUNCTION_LIST /end CHARACTERISTIC
/begin CHARACTERISTIC UpperFanPoint "Temp at 80W" VALUE 0x800380C4 RECORD_LAYOUT__1 0 COMPU_METHOD__5 -1E+17 1E+17 /begin FUNCTION_LIST Foreground /end FUNCTION_LIST /end CHARACTERISTIC
/begin CHARACTERISTIC Vehicle_direction "" VALUE 0x800380D0 RECORD_LAYOUT__1 0 COMPU_METHOD__2 -1E+17 1E+17 /begin FUNCTION_LIST Command_Troque /end FUNCTION_LIST /end CHARACTERISTIC
/begin CHARACTERISTIC XCP1__XCP_BC_ID "CAN message ID used to identify XCP targets on the CAN bus. This should be the same for all ECUs on the CAN bus. This is how Raptor-Cal discovers ECUs on the CAN bus." VALUE 0x80038248 RECORD_LAYOUT__5 0 COMPU_METHOD__7 0 4294967295 /begin FUNCTION_LIST XCP /end FUNCTION_LIST /end CHARACTERISTIC
/begin CHARACTERISTIC XCP1__XCP_RX_ID "CAN message ID that the module will receive CMD and STIM commands from the calibration tool on." VALUE 0x8003824C RECORD_LAYOUT__5 0 COMPU_METHOD__7 0 4294967295 /begin FUNCTION_LIST XCP /end FUNCTION_LIST /end CHARACTERISTIC
/begin CHARACTERISTIC XCP1__XCP_Security "Calibration to change XCP security, takes effect at next power-up." VALUE 0x80038256 RECORD_LAYOUT__3 0 COMPU_METHOD__18 0 65535 /begin FUNCTION_LIST XCP /end FUNCTION_LIST /end CHARACTERISTIC
/begin CHARACTERISTIC XCP1__XCP_TX_ID "CAN message ID that the module will send RES, ERR, EV, SERV and DAQ commands to the calibration tool on." VALUE 0x80038250 RECORD_LAYOUT__5 0 COMPU_METHOD__7 0 4294967295 /begin FUNCTION_LIST XCP /end FUNCTION_LIST /end CHARACTERISTIC
/begin AXIS_PTS RPM "" 0x800380D4 /*InputQuantity */ RPM_IN RECORD_LAYOUT__4 0 COMPU_METHOD__9 /*MaxAxisPoints */ 33 -1E+17 1E+17 /*Deposit Mode */ DEPOSIT ABSOLUTE /begin FUNCTION_LIST Calculate_Torque /end FUNCTION_LIST /end AXIS_PTS
/begin FUNCTION Accelerator "Accelerator" /begin SUB_FUNCTION Foreground FunctionCall_Subsystem Power_Up_Down /end SUB_FUNCTION /end FUNCTION
/begin FUNCTION Foreground "Foreground"
 /begin SUB_FUNCTION Calculate_Torque Command_Troque GLV_Used_Ah Override POT1 POT2 /end SUB_FUNCTION
/end FUNCTION
/begin FUNCTION Calculate_Torque "Calculate_Torque" /end FUNCTION
/begin FUNCTION Command_Troque "Command_Troque" /begin SUB_FUNCTION Override_1_ /end SUB_FUNCTION /end FUNCTION
/begin FUNCTION Override_1_ "Override" /end FUNCTION
/begin FUNCTION GLV_Used_Ah "GLV_Used_Ah" /end FUNCTION
/begin FUNCTION Override "Override" /end FUNCTION
/begin FUNCTION POT1 "POT1" /begin SUB_FUNCTION Override_2_ /end SUB_FUNCTION /end FUNCTION
/begin FUNCTION Override_2_ "Override" /end FUNCTION
/begin FUNCTION POT2 "POT2" /begin SUB_FUNCTION Override_3_ /end SUB_FUNCTION /end FUNCTION
/begin FUNCTION Override_3_ "Override" /end FUNCTION
/begin FUNCTION FunctionCall_Subsystem "FunctionCall_Subsystem" /end FUNCTION
/begin FUNCTION Power_Up_Down "Power_Up_Down" /begin SUB_FUNCTION Background /end SUB_FUNCTION /end FUNCTION
/begin FUNCTION Background "Background" /begin SUB_FUNCTION Raise_Startup_Event /end SUB_FUNCTION /end FUNCTION
/begin FUNCTION Raise_Startup_Event "Raise_Startup_Event" /end FUNCTION
/begin FUNCTION Diagnostics "Diagnostics" /begin SUB_FUNCTION PowerUp_Down /end SUB_FUNCTION /end FUNCTION
/begin FUNCTION PowerUp_Down "PowerUp_Down" /end FUNCTION
/begin FUNCTION System "System" /begin SUB_FUNCTION CAN FaultManager Platform XCP /end SUB_FUNCTION /end FUNCTION
/begin FUNCTION CAN "CAN" /end FUNCTION
/begin FUNCTION FaultManager "FaultManager" /end FUNCTION
/begin FUNCTION Platform "Platform" /begin SUB_FUNCTION EngineConfig /end SUB_FUNCTION /end FUNCTION
/begin FUNCTION EngineConfig "EngineConfig" /begin SUB_FUNCTION Fuel /end SUB_FUNCTION /end FUNCTION
/begin FUNCTION Fuel "Fuel" /end FUNCTION
/begin FUNCTION XCP "XCP" /end FUNCTION
/begin USER_RIGHTS Access1 /begin REF_GROUP GroupAccess1 /end REF_GROUP /end USER_RIGHTS
/begin USER_RIGHTS Access4 /begin REF_GROUP GroupAccess4 /end REF_GROUP /end USER_RIGHTS
/begin GROUP GroupAccess1
 /begin REF_CHARACTERISTIC KeySwHiTimeThr KeySwLoTimeThr UpperFanPoint LowerFanPoint Cooling_pump_PWM_D APP_override_OvrVal APP_override_OvrSts APP_default_err_override_OvrVal APP_default_err_override_OvrSts Vehicle_direction Direction_cmd_override_OvrVal Direction_cmd_override_OvrSts POT1_InputHi_Override_OvrVal POT1_InputHi_Override_OvrSts POT1_InputLow_Override_OvrVal POT1_InputLow_Override_OvrSts POT1_ADC_OvrVal POT1_ADC_OvrSts POT1_ADCHiPT POT1_ADCLoPT POT1_OvrVal POT1_OvrSts APP1_override_OvrVal APP1_override_OvrSts POT2_InputHi_Override_OvrVal POT2_InputHi_Override_OvrSts POT2_InputLow_Override_OvrVal POT2_InputLow_Override_OvrSts POT2_ADC_OvrVal POT2_ADC_OvrSts POT2_ADCHiPT POT2_ADCLoPT POT2_OvrVal POT2_OvrSts APP2_override_OvrVal APP2_override_OvrSts Starter_button_raw_override_OvrVal Starter_button_raw_override_OvrSts Safety_loop_error_raw_override_OvrVal Safety_loop_error_raw_override_OvrSts Starter_button_override_OvrVal Starter_button_override_OvrSts Precharge_raw_override_OvrVal Precharge_raw_override_OvrSts Charge_mode_raw_override_OvrVal Charge_mode_raw_override_OvrSts Cooling_fault_any_override_OvrVal Cooling_fault_any_override_OvrSts Drive_enable_override_OvrVal Drive_enable_override_OvrSts Inverter_enb_override_OvrVal Inverter_enb_override_OvrSts RPM_override_OvrVal RPM_override_OvrSts RPM MaxTorqueMap Torque_map_val_override_OvrVal Torque_map_val_override_OvrSts Torque_cmd_override_OvrVal Torque_cmd_override_OvrSts RTDS_override_OvrVal RTDS_override_OvrSts TSMS_ADC_override_OvrVal TSMS_ADC_override_OvrSts IMD_GLV_override_OvrVal IMD_GLV_override_OvrSts IMD_OkHs_override_OvrVal IMD_OkHs_override_OvrSts Temp_adc_raw_override_OvrVal Temp_adc_raw_override_OvrSts Temp_resistance_override_OvrVal Temp_resistance_override_OvrSts Temp_actual_celsius_override_OvrVal Temp_actual_celsius_override_OvrSts tempRateFault eradicTemp_X_Limit eradicTemp_Y_Limit tempSenseOC_X_Limit tempSenseOC_Y_Limit tempSenseSC_X_Limit tempSenseSC_Y_Limit tempHigh_X_Limit tempHigh_Y_Limit Throttle_plausibility_X_Limit Throttle_plausibility_Y_Limit Fan_PWM_D_override_OvrVal Fan_PWM_D_override_OvrSts Fan_PWM_freq Pump_PWM_freq POT1_InputHighThresh POT1_InputLowThresh POT2_InputHighThresh POT2_InputLowThresh GLV_hall_out_raw_override_OvrVal GLV_hall_out_raw_override_OvrSts Flowrate_hz_corrected_override_OvrVal Flowrate_hz_corrected_override_OvrSts Flow_rate_gpm_override_OvrVal Flow_rate_gpm_override_OvrSts lowFlowRateFault lowFlowRate_X_Limit lowFlowRate_Y_Limit eradicFlowRateFault eradicFlow_X_Limit eradicFlow_Y_Limit BMS_SOC_raw_override_OvrVal BMS_SOC_raw_override_OvrSts XCP1__XCP_BC_ID XCP1__XCP_RX_ID XCP1__XCP_TX_ID ModelName BuildNumber MatlabVersion RaptorVersion SwIdTxt CalIdTxt BuildUID IdTableRev HardwareType DateStamp INPUT29_ADCMon_HoldCount XCP1__XCP_Security CAN1_Startup_Delay CAN1_ErrorCheck_Interval CAN1_ErrorPassive_Delay CAN2_Startup_Delay CAN2_ErrorCheck_Interval CAN2_ErrorPassive_Delay SyC_tiPostDrvMax_C SyC_tiPostDrvMin_C SyC_tiPostDrvResv_C InjCDrv_EndOfStart EndOfStart /end REF_CHARACTERISTIC
 /begin REF_MEASUREMENT FgndTasksStopped Startup_Charge GLV_Battery_Charge KeySw_Bgnd KeepModuleOn AbsoluteTime Session_Used_Ah Battery_Percent_Charge Used_Ah POT1_InputHi_Override POT1_InputLow_Override POT1_ADC POT1 POT2_InputHi_Override POT2_InputLow_Override POT2_ADC POT2 RPM_IN Torque_cmd Direction_cmd Precharge_status Starter_button Safety_loop_error_logic RTDS Temp_adc_raw Temp_resistance Cooling_fault_any Charge_mode Starter_button_latch_q_naught fault_tempSenseOC fault_tempSenseSC fault_tempSenseHigh fault_eradic_temp fault_lowFlowRate fault_eradicFlowRate Fan_PWM_D TSMS_logic_probe IMD_OkHs_probe IMD_GLV_probe RPM_val TP_val APP1 APP2 Throttle_plausibility_probe Drive_enable POT1HighProbe POT1LowProbe POT1_ADC_Raw POT2HighProbe POT2LowProbe POT2_ADC_Raw GLV_hall_adc GLV_hall_amp Flow_rate_freq_corrected Flow_rate_gpm BMS_SOC_percent CAN1_CANTX_QueueOverrun CAN1_CANTX_QueueCount CAN1_CANTX_QueueMax CAN1_CANRX_QueueOverrun CAN1_CANRX_QueueCount CAN1_CANRX_QueueMax CAN2_CANTX_QueueOverrun CAN2_CANTX_QueueCount CAN2_CANTX_QueueMax Reset_xHistBuf OCWDA_stWDAPtt ResetReason ResetGroupId B_pwf NumberOfResetsSincePowerOnReset ContextSaveAreaSize SystemStackSize UserStackSize MaxContextSaveAreaSize MaxSystemStackSize MaxUserStackSize EEPROM_State /end REF_MEASUREMENT
/end GROUP
/begin GROUP GroupAccess4
 /begin REF_CHARACTERISTIC POT1_InputHi_X_Limit POT1_InputHi_Y_Limit POT1_InputLow_X_Limit POT1_InputLow_Y_Limit POT2_InputHi_X_Limit POT2_InputHi_Y_Limit POT2_InputLow_X_Limit POT2_InputLow_Y_Limit POT1_InputHi_FaultOperation POT1_InputLow_FaultOperation POT2_InputHi_FaultOperation POT2_InputLow_FaultOperation Throttle_plausibility_FaultOperation eradicFlow_FaultOperation eradicTemp_FaultOperation lowFlowRate_FaultOperation tempHigh_FaultOperation tempSenseOC_FaultOperation tempSenseSC_FaultOperation /end REF_CHARACTERISTIC
 /begin REF_MEASUREMENT Temp_actual_celsius Counter /end REF_MEASUREMENT
/end GROUP
/end MODULE
/end PROJECT
